## arch/sh/config.in
```kconfig
#
# For a description of the syntax of this configuration file,
# see the Configure script.
#
mainmenu_name "Linux/SuperH Kernel Configuration"

mainmenu_option next_comment
comment 'Code maturity level options'
bool 'Prompt for development and/or incomplete code/drivers' CONFIG_EXPERIMENTAL
endmenu

mainmenu_option next_comment
comment 'Processor type and features'
choice 'Processor type' \
   "SH7708 CONFIG_CPU_SUBTYPE_SH7708 \
    SH7709 CONFIG_CPU_SUBTYPE_SH7709 \
    SH7750 CONFIG_CPU_SUBTYPE_SH7750" SH7708
if [ "$CONFIG_CPU_SUBTYPE_SH7708" = "y" ]; then
   define_bool CONFIG_CPU_SH3 y
   define_bool CONFIG_CPU_SH4 n
fi
if [ "$CONFIG_CPU_SUBTYPE_SH7709" = "y" ]; then
   define_bool CONFIG_CPU_SH3 y
   define_bool CONFIG_CPU_SH4 n
fi
if [ "$CONFIG_CPU_SUBTYPE_SH7750" = "y" ]; then
   define_bool CONFIG_CPU_SH3 n
   define_bool CONFIG_CPU_SH4 y
fi
bool 'Little Endian' CONFIG_LITTLE_ENDIAN
hex 'Physical memory start address' CONFIG_MEMORY_START 08000000
bool 'Use SH CPU internal real time clock' CONFIG_SH_CPU_RTC
endmenu

mainmenu_option next_comment
comment 'Loadable module support'
bool 'Enable loadable module support' CONFIG_MODULES
if [ "$CONFIG_MODULES" = "y" ]; then
   bool 'Set version information on all symbols for modules' CONFIG_MODVERSIONS
   bool 'Kernel module loader' CONFIG_KMOD
fi
endmenu

mainmenu_option next_comment
comment 'General setup'
bool 'Networking support' CONFIG_NET
bool 'System V IPC' CONFIG_SYSVIPC
bool 'BSD Process Accounting' CONFIG_BSD_PROCESS_ACCT
bool 'Sysctl support' CONFIG_SYSCTL

if [ "$CONFIG_PROC_FS" = "y" ]; then
   choice 'Kernel core (/proc/kcore) format' \
	"ELF		CONFIG_KCORE_ELF	\
	 A.OUT		CONFIG_KCORE_AOUT" ELF
fi

tristate 'Kernel support for ELF binaries' CONFIG_BINFMT_ELF
tristate 'Kernel support for MISC binaries' CONFIG_BINFMT_MISC
endmenu

mainmenu_option next_comment
comment 'Character devices'
define_bool CONFIG_SERIAL n
define_bool CONFIG_SERIAL_CONSOLE y
bool 'SuperH SCI support' CONFIG_SH_SCI_SERIAL
bool 'SuperH SCIF support' CONFIG_SH_SCIF_SERIAL
endmenu

mainmenu_option next_comment
comment 'Floppy, IDE, and other block devices'

tristate 'RAM disk support' CONFIG_BLK_DEV_RAM
if [ "$CONFIG_BLK_DEV_RAM" = "y" ]; then
   bool '  Initial RAM disk (initrd) support' CONFIG_BLK_DEV_INITRD
fi

tristate 'Loopback device support' CONFIG_BLK_DEV_LOOP
tristate 'Network block device support' CONFIG_BLK_DEV_NBD
endmenu

if [ "$CONFIG_NET" = "y" ]; then
   source net/Config.in
   mainmenu_option next_comment
   comment 'Network device drivers'
      source drivers/net/Config.in
   endmenu
fi

mainmenu_option next_comment
comment 'Unix 98 PTY support'
bool 'Unix98 PTY support' CONFIG_UNIX98_PTYS
if [ "$CONFIG_UNIX98_PTYS" = "y" ]; then
   int 'Maximum number of Unix98 PTYs in use (0-2048)' CONFIG_UNIX98_PTY_COUNT 256
fi
endmenu

source fs/Config.in

mainmenu_option next_comment
comment 'Watchdog'

tristate 'Software watchdog' CONFIG_SOFT_WATCHDOG
endmenu

mainmenu_option next_comment
comment 'Kernel hacking'

bool 'Magic SysRq key' CONFIG_MAGIC_SYSRQ
bool 'GDB Stub kernel debug' CONFIG_DEBUG_KERNEL_WITH_GDB_STUB
endmenu
```
