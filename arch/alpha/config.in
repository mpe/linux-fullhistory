## arch/i386/config.in
```kconfig
#
# For a description of the syntax of this configuration file,
# see the Configure script.
#
mainmenu_name "Linux Kernel Configuration"

define_bool CONFIG_X86 y
define_bool CONFIG_ISA y

define_bool CONFIG_UID16 y

mainmenu_option next_comment
comment 'Code maturity level options'
bool 'Prompt for development and/or incomplete code/drivers' CONFIG_EXPERIMENTAL
endmenu

mainmenu_option next_comment
comment 'Processor type and features'
choice 'Processor family' \
	"386			CONFIG_M386	\
	 486/Cx486		CONFIG_M486	\
	 586/K5/5x86/6x86	CONFIG_M586	\
	 Pentium/TSC		CONFIG_M586TSC	\
	 PPro/6x86MX		CONFIG_M686 \
	 K6-I/II/II		CONFIG_MK6 \
	 Athlon                 CONFIG_MK7" PPro
#
# Define implied options from the CPU selection here
#
if [ "$CONFIG_M386" != "y" ]; then
   define_bool CONFIG_X86_WP_WORKS_OK y
   define_bool CONFIG_X86_INVLPG y
   define_bool CONFIG_X86_BSWAP y
   define_bool CONFIG_X86_POPAD_OK y
fi
if [ "$CONFIG_M686" = "y" -o "$CONFIG_M586TSC" = "y" ]; then
   define_bool CONFIG_X86_TSC y
fi
if [ "$CONFIG_M686" = "y" ]; then
   define_bool CONFIG_X86_GOOD_APIC y
   define_bool CONFIG_X86_PGE y
fi
if [ "$CONFIG_MK6" = "y" ]; then
   define_bool CONFIG_X86_TSC y
fi
if [ "$CONFIG_MK7" = "y" ]; then
   define_bool CONFIG_X86_TSC y
   define_bool CONFIG_X86_GOOD_APIC y
   define_bool CONFIG_X86_USE_3DNOW y
fi

choice 'High Memory Support' \
	"off    CONFIG_NOHIGHMEM \
	4GB    CONFIG_HIGHMEM4G \
	64GB   CONFIG_HIGHMEM64G" off
if [ "$CONFIG_HIGHMEM4G" = "y" ]; then
   define_bool CONFIG_HIGHMEM y
fi
if [ "$CONFIG_HIGHMEM64G" = "y" ]; then
   define_bool CONFIG_HIGHMEM y
   define_bool CONFIG_X86_PAE y
fi

bool 'Math emulation' CONFIG_MATH_EMULATION
bool 'MTRR (Memory Type Range Register) support' CONFIG_MTRR
bool 'Symmetric multi-processing support' CONFIG_SMP
if [ "$CONFIG_SMP" != "y" ]; then
    bool 'APIC and IO-APIC support on uniprocessors' CONFIG_X86_UP_IOAPIC
    if [ "$CONFIG_X86_UP_IOAPIC" = "y" ]; then
       define_bool CONFIG_X86_IO_APIC y
       define_bool CONFIG_X86_LOCAL_APIC y
    fi
fi
endmenu

mainmenu_option next_comment
comment 'Loadable module support'
bool 'Enable loadable module support' CONFIG_MODULES
if [ "$CONFIG_MODULES" = "y" ]; then
   bool '  Set version information on all module symbols' CONFIG_MODVERSIONS
   bool '  Kernel module loader' CONFIG_KMOD
fi
endmenu

mainmenu_option next_comment
comment 'General setup'

bool 'Networking support' CONFIG_NET
bool 'SGI Visual Workstation support' CONFIG_VISWS
if [ "$CONFIG_VISWS" = "y" ]; then
   define_bool CONFIG_X86_VISWS_APIC y
   define_bool CONFIG_X86_LOCAL_APIC y
   define_bool CONFIG_PCI y
else
   if [ "$CONFIG_SMP" = "y" ]; then
      define_bool CONFIG_X86_IO_APIC y
      define_bool CONFIG_X86_LOCAL_APIC y
   fi
   bool 'PCI support' CONFIG_PCI
   if [ "$CONFIG_PCI" = "y" ]; then
      choice '  PCI access mode' \
	"BIOS		CONFIG_PCI_GOBIOS	\
	 Direct		CONFIG_PCI_GODIRECT	\
	 Any		CONFIG_PCI_GOANY"	Any
      if [ "$CONFIG_PCI_GOBIOS" = "y" -o "$CONFIG_PCI_GOANY" = "y" ]; then
         define_bool CONFIG_PCI_BIOS y
      fi
      if [ "$CONFIG_PCI_GODIRECT" = "y" -o "$CONFIG_PCI_GOANY" = "y" ]; then
         define_bool CONFIG_PCI_DIRECT y
      fi
   fi
fi

source drivers/pci/Config.in

if [ "$CONFIG_VISWS" != "y" ]; then
   bool 'MCA support' CONFIG_MCA
fi

bool 'Support for hot-pluggable devices' CONFIG_HOTPLUG

if [ "$CONFIG_HOTPLUG" = "y" ] ; then
   source drivers/pcmcia/Config.in
fi

bool 'System V IPC' CONFIG_SYSVIPC
bool 'BSD Process Accounting' CONFIG_BSD_PROCESS_ACCT
bool 'Sysctl support' CONFIG_SYSCTL
if [ "$CONFIG_PROC_FS" = "y" ]; then
   choice 'Kernel core (/proc/kcore) format' \
	"ELF		CONFIG_KCORE_ELF	\
	 A.OUT		CONFIG_KCORE_AOUT" ELF
fi
tristate 'Kernel support for a.out binaries' CONFIG_BINFMT_AOUT
tristate 'Kernel support for ELF binaries' CONFIG_BINFMT_ELF
tristate 'Kernel support for MISC binaries' CONFIG_BINFMT_MISC

source drivers/parport/Config.in

bool 'ACPI support' CONFIG_ACPI
if [ "$CONFIG_ACPI" != "n" ]; then
   if [ "$CONFIG_EXPERIMENTAL" = "y" ]; then
      bool '  Enter S1 for sleep (EXPERIMENTAL)' CONFIG_ACPI_S1_SLEEP
   fi
fi

bool 'Advanced Power Management BIOS support' CONFIG_APM
if [ "$CONFIG_APM" != "n" ]; then
   bool '  Ignore USER SUSPEND' CONFIG_APM_IGNORE_USER_SUSPEND
   bool '  Enable PM at boot time' CONFIG_APM_DO_ENABLE
   bool '  Make CPU Idle calls when idle' CONFIG_APM_CPU_IDLE
   bool '  Enable console blanking using APM' CONFIG_APM_DISPLAY_BLANK
   bool '  Ignore multiple suspend' CONFIG_APM_IGNORE_MULTIPLE_SUSPEND
   bool '  Ignore multiple suspend/resume cycles' CONFIG_APM_IGNORE_SUSPEND_BOUNCE
   bool '  RTC stores time in GMT' CONFIG_APM_RTC_IS_GMT
   bool '  Allow interrupts during APM BIOS calls' CONFIG_APM_ALLOW_INTS
   bool '  Entry point offset fix (some Acer laptops)' CONFIG_APM_BAD_ENTRY_OFFSET
   bool '  Use real mode APM BIOS call to power off' CONFIG_APM_REAL_MODE_POWER_OFF
fi

endmenu


source drivers/pnp/Config.in

source drivers/block/Config.in

if [ "$CONFIG_NET" = "y" ]; then
   source net/Config.in
fi

source drivers/telephony/Config.in

mainmenu_option next_comment
comment 'SCSI support'

tristate 'SCSI support' CONFIG_SCSI

if [ "$CONFIG_SCSI" != "n" ]; then
   source drivers/scsi/Config.in
fi
endmenu

source drivers/ieee1394/Config.in

source drivers/i2o/Config.in

if [ "$CONFIG_NET" = "y" ]; then
   mainmenu_option next_comment
   comment 'Network device support'

   bool 'Network device support' CONFIG_NETDEVICES
   if [ "$CONFIG_NETDEVICES" = "y" ]; then
      source drivers/net/Config.in
      if [ "$CONFIG_ATM" = "y" ]; then
         source drivers/atm/Config.in
      fi
   fi
   endmenu
fi

source net/ax25/Config.in

source net/irda/Config.in

mainmenu_option next_comment
comment 'ISDN subsystem'
if [ "$CONFIG_NET" != "n" ]; then
   tristate 'ISDN support' CONFIG_ISDN
   if [ "$CONFIG_ISDN" != "n" ]; then
      source drivers/isdn/Config.in
   fi
fi
endmenu

mainmenu_option next_comment
comment 'Old CD-ROM drivers (not SCSI, not IDE)'

bool 'Support non-SCSI/IDE/ATAPI CDROM drives' CONFIG_CD_NO_IDESCSI
if [ "$CONFIG_CD_NO_IDESCSI" != "n" ]; then
   source drivers/cdrom/Config.in
fi
endmenu

source drivers/char/Config.in

source drivers/usb/Config.in

source drivers/misc/Config.in

source fs/Config.in

if [ "$CONFIG_VT" = "y" ]; then
   mainmenu_option next_comment
   comment 'Console drivers'
   bool 'VGA text console' CONFIG_VGA_CONSOLE
   bool 'Video mode selection support' CONFIG_VIDEO_SELECT
   if [ "$CONFIG_EXPERIMENTAL" = "y" ]; then
      tristate 'MDA text console (dual-headed) (EXPERIMENTAL)' CONFIG_MDA_CONSOLE
      source drivers/video/Config.in
   fi
   endmenu
fi

mainmenu_option next_comment
comment 'Sound'

tristate 'Sound card support' CONFIG_SOUND
if [ "$CONFIG_SOUND" != "n" ]; then
   source drivers/sound/Config.in
fi
endmenu

mainmenu_option next_comment
comment 'Kernel hacking'

#bool 'Debug kmalloc/kfree' CONFIG_DEBUG_MALLOC
bool 'Magic SysRq key' CONFIG_MAGIC_SYSRQ
endmenu
```

## arch/ia64/config.in
```kconfig
mainmenu_name "Kernel configuration of Linux for IA-64 machines"

mainmenu_option next_comment
comment 'General setup'

define_bool CONFIG_IA64 y

choice 'IA-64 system type'					\
	"Generic		CONFIG_IA64_GENERIC		\
	 HP-simulator		CONFIG_IA64_HP_SIM		\
	 SN1-simulator		CONFIG_IA64_SGI_SN1_SIM		\
	 DIG-compliant		CONFIG_IA64_DIG" Generic

choice 'Kernel page size'						\
	"4KB			CONFIG_IA64_PAGE_SIZE_4KB		\
	 8KB			CONFIG_IA64_PAGE_SIZE_8KB		\
	 16KB			CONFIG_IA64_PAGE_SIZE_16KB		\
	 64KB			CONFIG_IA64_PAGE_SIZE_64KB" 16KB

if [ "$CONFIG_IA64_DIG" = "y" ]; then
	bool '  Enable Itanium A-step specific code' CONFIG_ITANIUM_ASTEP_SPECIFIC
	bool '  Enable SoftSDV hacks' CONFIG_IA64_SOFTSDV_HACKS n
	bool '  Enable BigSur hacks' CONFIG_IA64_BIGSUR_HACKS y
	bool '  Enable Lion hacks' CONFIG_IA64_LION_HACKS n
	bool '  Emulate PAL/SAL/EFI firmware' CONFIG_IA64_FW_EMU n
	bool '  Get PCI IRQ routing from firmware/ACPI'	CONFIG_IA64_IRQ_ACPI y
fi

if [ "$CONFIG_IA64_GENERIC" = "y" ]; then
	define_bool CONFIG_IA64_SOFTSDV_HACKS y
fi

if [ "$CONFIG_IA64_SGI_SN1_SIM" = "y" ]; then
	define_bool CONFIG_NUMA y
	define_bool CONFIG_IA64_SOFTSDV_HACKS y
fi

define_bool CONFIG_KCORE_ELF y	# On IA-64, we always want an ELF /proc/kcore.

bool 'SMP support' CONFIG_SMP n
bool 'Performance monitor support' CONFIG_PERFMON n

bool 'Networking support' CONFIG_NET n
bool 'System V IPC' CONFIG_SYSVIPC n
bool 'BSD Process Accounting' CONFIG_BSD_PROCESS_ACCT n
bool 'Sysctl support' CONFIG_SYSCTL n
tristate 'Kernel support for ELF binaries' CONFIG_BINFMT_ELF
tristate 'Kernel support for MISC binaries' CONFIG_BINFMT_MISC

bool 'PCI support' CONFIG_PCI n
source drivers/pci/Config.in

source drivers/pcmcia/Config.in

mainmenu_option next_comment
 comment 'Code maturity level options'
 bool 'Prompt for development and/or incomplete code/drivers' \
	CONFIG_EXPERIMENTAL n
endmenu

mainmenu_option next_comment
 comment 'Loadable module support'
 bool 'Enable loadable module support' CONFIG_MODULES n
 if [ "$CONFIG_MODULES" = "y" ]; then
  bool 'Set version information on all symbols for modules' CONFIG_MODVERSIONS n
  bool 'Kernel module loader' CONFIG_KMOD n
 fi
endmenu

source drivers/parport/Config.in

endmenu

source drivers/pnp/Config.in
source drivers/block/Config.in
source drivers/i2o/Config.in

if [ "$CONFIG_NET" = "y" ]; then
  source net/Config.in
fi

mainmenu_option next_comment
comment 'SCSI support'

tristate 'SCSI support' CONFIG_SCSI

if [ "$CONFIG_SCSI" != "n" ]; then
  source drivers/scsi/Config.in
  bool 'Simulated SCSI disk' CONFIG_SCSI_SIM n
fi
endmenu

if [ "$CONFIG_NET" = "y" ]; then
  mainmenu_option next_comment
  comment 'Network device support'

  bool 'Network device support' CONFIG_NETDEVICES n
  if [ "$CONFIG_NETDEVICES" = "y" ]; then
    source drivers/net/Config.in
  fi
  endmenu
fi

source net/ax25/Config.in

mainmenu_option next_comment
comment 'ISDN subsystem'

tristate 'ISDN support' CONFIG_ISDN
if [ "$CONFIG_ISDN" != "n" ]; then
  source drivers/isdn/Config.in
fi
endmenu

mainmenu_option next_comment
comment 'CD-ROM drivers (not for SCSI or IDE/ATAPI drives)'

bool 'Support non-SCSI/IDE/ATAPI drives' CONFIG_CD_NO_IDESCSI n
if [ "$CONFIG_CD_NO_IDESCSI" != "n" ]; then
  source drivers/cdrom/Config.in
fi
endmenu

source drivers/char/Config.in
source drivers/usb/Config.in
#source drivers/misc/Config.in

source fs/Config.in

source fs/nls/Config.in

if [ "$CONFIG_VT" = "y" ]; then
  mainmenu_option next_comment
  comment 'Console drivers'
  bool 'VGA text console' CONFIG_VGA_CONSOLE n
  if [ "$CONFIG_FB" = "y" ]; then
    define_bool CONFIG_PCI_CONSOLE y
  fi
  source drivers/video/Config.in
  endmenu
fi

mainmenu_option next_comment
comment 'Sound'

tristate 'Sound card support' CONFIG_SOUND
if [ "$CONFIG_SOUND" != "n" ]; then
  source drivers/sound/Config.in
fi
endmenu

mainmenu_option next_comment
comment 'Kernel hacking'

#bool 'Debug kmalloc/kfree' CONFIG_DEBUG_MALLOC
if [ "$CONFIG_EXPERIMENTAL" = "y" ]; then
  tristate 'Kernel support for IA-32 emulation' CONFIG_IA32_SUPPORT
  tristate 'Kernel FP software completion' CONFIG_MATHEMU
else
  define_bool CONFIG_MATHEMU y
fi

bool 'Magic SysRq key' CONFIG_MAGIC_SYSRQ n
bool 'Early printk support (requires VGA!)' CONFIG_IA64_EARLY_PRINTK n
bool 'Turn on compare-and-exchange bug checking (slow!)' CONFIG_IA64_DEBUG_CMPXCHG n
bool 'Turn on irq debug checks (slow!)' CONFIG_IA64_DEBUG_IRQ n
bool 'Print possible IA64 hazards to console' CONFIG_IA64_PRINT_HAZARDS n
bool 'Built-in Kernel Debugger support' CONFIG_KDB
if [ "$CONFIG_KDB" = "y" ]; then
  bool 'Compile the kernel with frame pointers' CONFIG_KDB_FRAMEPTR
  int  'KDB Kernel Symbol Table size?' CONFIG_KDB_STBSIZE 10000
fi

endmenu
```
