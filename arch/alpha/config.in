## arch/mips/config.in
```kconfig
# $Id: config.in,v 1.27 1999/06/17 13:25:44 ralf Exp $
# For a description of the syntax of this configuration file,
# see the Configure script.
#
mainmenu_name "Linux Kernel Configuration"

mainmenu_option next_comment
comment 'Code maturity level options'
bool 'Prompt for development and/or incomplete code/drivers' CONFIG_EXPERIMENTAL
endmenu

mainmenu_option next_comment
comment 'Machine selection'
bool 'Support for Acer PICA 1 chipset' CONFIG_ACER_PICA_61
if [ "$CONFIG_EXPERIMENTAL" = "y" ]; then
   bool 'Support for Algorithmics P4032 (EXPERIMENTAL)' CONFIG_ALGOR_P4032
   bool 'Support for BAGET MIPS series (EXPERIMENTAL)' CONFIG_BAGET_MIPS
   bool 'Support for DECstations (EXPERIMENTAL)' CONFIG_DECSTATION
fi
bool 'Support for Mips Magnum 4000' CONFIG_MIPS_MAGNUM_4000
bool 'Support for Olivetti M700-10' CONFIG_OLIVETTI_M700
bool 'Support for SGI workstations' CONFIG_SGI
bool 'Support for SNI RM200 PCI' CONFIG_SNI_RM200_PCI

#
# Select some configuration options automatically for certain systems.
#
unset CONFIG_PCI
unset CONFIG_MIPS_JAZZ
unset CONFIG_VIDEO_G364

if [ "$CONFIG_ALGOR_P4032" = "y" ]; then
   define_bool CONFIG_PCI y
fi
if [ "$CONFIG_MIPS_MAGNUM_4000" = "y" -o \
     "$CONFIG_OLIVETTI_M700" = "y" ]; then
   define_bool CONFIG_MIPS_JAZZ y
   define_bool CONFIG_FB y
   define_bool CONFIG_FB_G364 y	
fi
if [ "$CONFIG_ACER_PICA_61" = "y" ]; then
   define_bool CONFIG_MIPS_JAZZ y
fi
if [ "$CONFIG_SNI_RM200_PCI" = "y" ]; then
   define_bool CONFIG_PCI y
fi
endmenu

mainmenu_option next_comment
comment 'CPU selection'

choice 'CPU type' \
	"R3000 CONFIG_CPU_R3000	\
	 R6000 CONFIG_CPU_R6000	\
	 R4300 CONFIG_CPU_R4300	\
	 R4x00 CONFIG_CPU_R4X00	\
	 R5000 CONFIG_CPU_R5000	\
	 R56x0 CONFIG_CPU_NEVADA \
	 R8000 CONFIG_CPU_R8000	\
	 R10000 CONFIG_CPU_R10000" R4x00
endmenu

mainmenu_option next_comment
comment 'General setup'

if [ "$CONFIG_DECSTATION" = "y" ]; then
   define_bool CONFIG_CPU_LITTLE_ENDIAN y
else
   bool 'Generate little endian code' CONFIG_CPU_LITTLE_ENDIAN
fi

define_bool CONFIG_ELF_KERNEL y

if [ "$CONFIG_CPU_LITTLE_ENDIAN" = "n" ]; then
   define_bool CONFIG_BINFMT_IRIX y
   define_bool CONFIG_FORWARD_KEYBOARD y
fi
define_bool CONFIG_BINFMT_AOUT n
define_bool CONFIG_BINFMT_ELF y
tristate 'Kernel support for MISC binaries' CONFIG_BINFMT_MISC

bool 'Networking support' CONFIG_NET
bool 'System V IPC' CONFIG_SYSVIPC
bool 'BSD Process Accounting' CONFIG_BSD_PROCESS_ACCT
bool 'Sysctl support' CONFIG_SYSCTL

if [ "$CONFIG_SGI" != "y" -a "$CONFIG_DECSTATION" != "y" -a "$CONFIG_BAGET_MIPS" != "y" ]; then
   source drivers/parport/Config.in
fi
endmenu

mainmenu_option next_comment
comment 'Loadable module support'
bool 'Enable loadable module support' CONFIG_MODULES
if [ "$CONFIG_MODULES" = "y" ]; then
   bool '  Set version information on all symbols for modules' CONFIG_MODVERSIONS
   bool '  Kernel module loader' CONFIG_KMOD
fi

endmenu

if [ "$CONFIG_DECSTATION" = "y" ]; then
   mainmenu_option next_comment
   comment 'TURBOchannel support'
   bool 'TURBOchannel support' CONFIG_TC
#   if [ "$CONFIG_TC" = "y" ]; then
#      tristate '  MAGMA Parallel port support' CONFIG_PARPORT
#   fi
   endmenu
fi

source drivers/i2o/Config.in

source drivers/pnp/Config.in

source drivers/block/Config.in

if [ "$CONFIG_NET" = "y" ]; then
   source net/Config.in
fi

mainmenu_option next_comment
comment 'SCSI support'

tristate 'SCSI support' CONFIG_SCSI

if [ "$CONFIG_SCSI" != "n" ]; then
   if [ "$CONFIG_SGI" = "y" -o "$CONFIG_DECSTATION" = "y" ]; then
      comment '  SCSI support type (disk, tape, CDrom)'

      dep_tristate '  SCSI disk support' CONFIG_BLK_DEV_SD $CONFIG_SCSI
      dep_tristate '  SCSI tape support' CONFIG_CHR_DEV_ST $CONFIG_SCSI
      dep_tristate '  SCSI CDROM support' CONFIG_BLK_DEV_SR $CONFIG_SCSI
      dep_tristate '  SCSI generic support' CONFIG_CHR_DEV_SG $CONFIG_SCSI

      comment 'Some SCSI devices (e.g. CD jukebox) support multiple LUNs'

      bool '  Probe all LUNs on each SCSI device' CONFIG_SCSI_MULTI_LUN

      bool '  Verbose SCSI error reporting' CONFIG_SCSI_CONSTANTS

      #mainmenu_option next_comment
      comment 'SCSI low-level drivers'
      if [ "$CONFIG_SGI" = "y" ]; then
	 dep_tristate 'SGI wd93 Scsi Driver' CONFIG_SCSI_SGIWD93 $CONFIG_SCSI
      else
	 if [ "$CONFIG_TC" = "y" ]; then
	    dep_tristate 'DEC NCR53C94 Scsi Driver' CONFIG_SCSI_DECNCR $CONFIG_SCSI
	 fi
	 dep_tristate 'DEC SII Scsi Driver' CONFIG_SCSI_DECSII $CONFIG_SCSI
      fi
   else
      source drivers/scsi/Config.in
   fi
fi
endmenu

if [ "$CONFIG_NET" = "y" ]; then
   mainmenu_option next_comment
   comment 'Network device support'

   bool 'Network device support' CONFIG_NETDEVICES
   if [ "$CONFIG_NETDEVICES" = "y" ]; then
      if [ "$CONFIG_SGI" != "y" -a "$CONFIG_DECSTATION" != "y" -a "$CONFIG_BAGET_MIPS" != "y" ]; then
	 source drivers/net/Config.in
      else
	 tristate '  Dummy net driver support' CONFIG_DUMMY
	 tristate '  SLIP (serial line) support' CONFIG_SLIP
	 if [ "$CONFIG_SLIP" != "n" ]; then
	    bool '    CSLIP compressed headers' CONFIG_SLIP_COMPRESSED
	    bool '    Keepalive and linefill' CONFIG_SLIP_SMART
	 fi
	 tristate '  PPP (point-to-point) support' CONFIG_PPP
	 if [ ! "$CONFIG_PPP" = "n" ]; then
	    comment '    CCP compressors for PPP are only built as modules.'
	 fi
         if [ "$CONFIG_SGI" = "y" ]; then
	 bool '  SGI Seeq ethernet controller support' CONFIG_SGISEEQ
      fi
      if [ "$CONFIG_DECSTATION" = "y" ]; then
         bool '  DEC LANCE ethernet controller support' CONFIG_DECLANCE
      fi
      if [ "$CONFIG_BAGET_MIPS" = "y" ]; then
	 tristate '  Baget AMD LANCE support' CONFIG_BAGETLANCE
	 tristate '  Baget Backplane Shared Memory support' CONFIG_BAGETBSM
      fi
   fi
   endmenu
fi

if [ "$CONFIG_SGI" != "y" -a "$CONFIG_DECSTATION" != "y" -a "$CONFIG_BAGET_MIPS" != "y" ]; then
   source drivers/net/hamradio/Config.in


   mainmenu_option next_comment
   comment 'ISDN subsystem'

   if [ "$CONFIG_NET" != "n" ]; then
      tristate 'ISDN support' CONFIG_ISDN
      if [ "$CONFIG_ISDN" != "n" ]; then
	 source drivers/isdn/Config.in
      fi
   fi
   endmenu


   mainmenu_option next_comment
   comment 'Old CD-ROM drivers (not SCSI, not IDE)'

   bool 'Support non-SCSI/IDE/ATAPI drives' CONFIG_CD_NO_IDESCSI
   if [ "$CONFIG_CD_NO_IDESCSI" != "n" ]; then
      source drivers/cdrom/Config.in
   fi
   endmenu
fi

if [ "$CONFIG_DECSTATION" != "y" ]; then
   source drivers/char/Config.in
else
   mainmenu_option next_comment
   comment 'DECstation Character devices'

   bool 'Virtual terminal' CONFIG_VT
   if [ "$CONFIG_VT" = "y" ]; then
      bool '  Support for console on virtual terminal' CONFIG_VT_CONSOLE
   fi
   if [ "$CONFIG_SGI" = "y" ]; then
      bool 'SGI PROM Console Support' CONFIG_SGI_PROM_CONSOLE
   fi
   tristate 'Standard/generic (dumb) serial support' CONFIG_SERIAL
   if [ "$CONFIG_SERIAL" = "y" ]; then
      bool '  DZ11 Serial Support' CONFIG_DZ
      if [ "$CONFIG_TC" = "y" ]; then
	 bool '  Z85C30 Serial Support' CONFIG_ZS
      fi
      bool '  Support for console on serial port' CONFIG_SERIAL_CONSOLE
   fi
   bool 'Unix98 PTY support' CONFIG_UNIX98_PTYS
   if [ "$CONFIG_UNIX98_PTYS" = "y" ]; then
      int 'Maximum number of Unix98 PTYs in use (0-2048)' CONFIG_UNIX98_PTY_COUNT 256
   fi
   bool 'Keyboard Support' CONFIG_KEYBOARD
   bool 'Mouse Support' CONFIG_MOUSE
#   bool 'Enhanced Real Time Clock Support' CONFIG_RTC
   endmenu
fi

source drivers/usb/Config.in

source fs/Config.in

if [ "$CONFIG_VT" = "y" ]; then
   mainmenu_option next_comment
   comment 'Console drivers'
   if [ "$CONFIG_SGI" = "y" ]; then
      tristate 'SGI Newport Console support' CONFIG_SGI_NEWPORT_CONSOLE
      if [ "$CONFIG_SGI_NEWPORT_CONSOLE" != "y" ]; then
         define_bool CONFIG_DUMMY_CONSOLE y
      fi
   else
      if [ "$CONFIG_DECSTATION" != "y" ]; then
	 bool 'VGA text console' CONFIG_VGA_CONSOLE
      fi
      bool 'Support for frame buffer devices' CONFIG_FB
	 source drivers/video/Config.in
      fi
   endmenu
fi

if [ "$CONFIG_DECSTATION" != "y" ]; then
   mainmenu_option next_comment
   comment 'Sound'

   tristate 'Sound card support' CONFIG_SOUND
   if [ "$CONFIG_SOUND" != "n" ]; then
      source drivers/sound/Config.in
   fi
   endmenu
fi

if [ "$CONFIG_SGI" = "y" ]; then
   source drivers/sgi/Config.in
fi

mainmenu_option next_comment
comment 'Kernel hacking'

#bool 'Debug kmalloc/kfree' CONFIG_DEBUG_MALLOC
bool 'Are you using a crosscompiler' CONFIG_CROSSCOMPILE
if [ "$CONFIG_MODULES" = "y" ]; then
   bool ' Build fp execption handler module' CONFIG_MIPS_FPE_MODULE
fi
if [ "$CONFIG_SERIAL" = "y" ]; then
   bool 'Remote GDB kernel debugging' CONFIG_REMOTE_DEBUG
fi
bool 'Magic SysRq key' CONFIG_MAGIC_SYSRQ
endmenu
```
