## arch/ppc/config.in
```kconfig
# $Id: config.in,v 1.106 1999/09/14 19:21:18 cort Exp $
# For a description of the syntax of this configuration file,
# see the Configure script.
#
define_bool CONFIG_UID16 n

mainmenu_name "Linux/PowerPC Kernel Configuration"

mainmenu_option next_comment
comment 'Code maturity level options'
bool 'Prompt for development and/or incomplete code/drivers' CONFIG_EXPERIMENTAL
endmenu

mainmenu_option next_comment
comment 'Platform support'
define_bool CONFIG_PPC y
choice 'Processor Type'	\
	"6xx/7xx/7400		CONFIG_6xx	\
	 4xx			CONFIG_4xx	\
	 630/Power3(64-Bit)	CONFIG_PPC64	\
	 82xx			CONFIG_82xx	\
	 8xx			CONFIG_8xx"	6xx/7xx

if [ "$CONFIG_4xx" = "y" ]; then
    choice 'Machine Type'			\
	"Oak			CONFIG_OAK 	\
	 Walnut			CONFIG_WALNUT"	Oak
fi

if [ "$CONFIG_8xx" = "y" ]; then
  define_bool CONFIG_SERIAL_CONSOLE y

  choice 'Processor Model'	\
	"821		CONFIG_MPC821		\
	 823		CONFIG_MPC823		\
	 850		CONFIG_MPC850		\
	 855		CONFIG_MPC855		\
	 860		CONFIG_MPC860		\
	 860T		CONFIG_MPC860T"		860

  choice 'Machine Type'		\
	"RPX-Lite	CONFIG_RPXLITE		\
	 RPX-Classic	CONFIG_RPXCLASSIC	\
	 BSE-IP		CONFIG_BSEIP		\
	 MBX		CONFIG_MBX		\
	 WinCept	CONFIG_WINCEPT"		RPX-Lite
fi
if [ "$CONFIG_6xx" = "y" ]; then
  choice 'Machine Type'		\
	"PowerMac/PReP/MTX/CHRP	CONFIG_ALL_PPC	\
	 Gemini		CONFIG_GEMINI		\
	 APUS		CONFIG_APUS"		PowerMac/PReP/MTX/CHRP
fi

if [ "$CONFIG_PPC64" = "y" ]; then
  define_bool CONFIG_ALL_PPC y
fi

bool 'Symmetric multi-processing support' CONFIG_SMP
if [ "$CONFIG_6xx" = "y" ];then
  bool 'AltiVec Support' CONFIG_ALTIVEC
fi

if [ "$CONFIG_ALL_PPC" != "y" ];then
  define_bool CONFIG_MACH_SPECIFIC y
fi

if [ "$CONFIG_4xx" = "y" -o "$CONFIG_8xx" = "y" ]; then
  bool 'Math emulation' CONFIG_MATH_EMULATION
fi
endmenu

mainmenu_option next_comment
comment 'Loadable module support'
bool 'Enable loadable module support' CONFIG_MODULES
if [ "$CONFIG_MODULES" = "y" ]; then
   bool '  Set version information on all module symbols' CONFIG_MODVERSIONS
   bool '  Kernel module loader' CONFIG_KMOD
fi
endmenu

mainmenu_option next_comment
comment 'General setup'

if [ "$CONFIG_APUS" = "y" ]; then
  define_bool CONFIG_PCI n
fi
if [ "$CONFIG_OAK" = "y" ]; then
  define_bool CONFIG_PCI n
fi
if [ "$CONFIG_8xx" = "y" ]; then
    bool 'QSpan PCI' CONFIG_PCI
fi
if [ "$CONFIG_6xx" = "y" -a "$CONFIG_APUS" != "y" ]; then
    define_bool CONFIG_PCI y
fi
if [ "$CONFIG_PREP" = "y" -o "$CONFIG_PMAC" = "y" -o "$CONFIG_CHRP" = "y" -o "$CONFIG_ALL_PPC" = "y" ]; then
    define_bool CONFIG_PCI y
fi

bool 'Networking support' CONFIG_NET
bool 'Sysctl support' CONFIG_SYSCTL
bool 'System V IPC' CONFIG_SYSVIPC
bool 'BSD Process Accounting' CONFIG_BSD_PROCESS_ACCT

# only elf supported, a.out is not -- Cort
if [ "$CONFIG_PROC_FS" = "y" ]; then
   define_bool CONFIG_KCORE_ELF y
fi
define_bool CONFIG_BINFMT_ELF y
define_bool CONFIG_KERNEL_ELF y
tristate 'Kernel support for MISC binaries' CONFIG_BINFMT_MISC

source drivers/pci/Config.in

bool 'Support for hot-pluggable devices' CONFIG_HOTPLUG

if [ "$CONFIG_HOTPLUG" = "y" ]; then
   source drivers/pcmcia/Config.in
fi

source drivers/parport/Config.in

if [ "$CONFIG_4xx" != "y" -a "$CONFIG_8xx" != "y" ]; then
  bool 'Support for VGA Console' CONFIG_VGA_CONSOLE
  bool 'Support for frame buffer devices' CONFIG_FB
  if [ "$CONFIG_FB" = "y" ]; then
    bool 'Backward compatibility mode for Xpmac' CONFIG_FB_COMPAT_XPMAC
  fi

  bool 'Power management support for PowerBooks' CONFIG_PMAC_PBOOK
  bool 'Support for PowerMac floppy' CONFIG_MAC_FLOPPY
  tristate 'Support for PowerMac serial ports' CONFIG_MAC_SERIAL
  if [ "$CONFIG_MAC_SERIAL" = "y" ]; then
     bool '   Support for console on serial port' CONFIG_SERIAL_CONSOLE
  fi
  bool 'Apple Desktop Bus (ADB) support' CONFIG_ADB
  if [ "$CONFIG_ADB" = "y" ]; then
     bool '   Include CUDA ADB driver' CONFIG_ADB_CUDA
     bool '   Include MacIO ADB driver' CONFIG_ADB_MACIO
     bool '   Include PMU (Powerbook) ADB driver' CONFIG_ADB_PMU
     bool 'Support for ADB keyboard' CONFIG_ADB_KEYBOARD 
     bool 'Support for ADB mouse' CONFIG_ADBMOUSE
  fi
  bool 'Support for Open Firmware device tree in /proc' CONFIG_PROC_DEVICETREE
  bool 'Support for TotalImpact TotalMP' CONFIG_TOTALMP
  bool 'Support for early boot text console (BootX only)' CONFIG_BOOTX_TEXT
  bool 'Support for Motorola Hot Swap' CONFIG_MOTOROLA_HOTSWAP
fi

if [ "$CONFIG_PREP" = "y" -o "$CONFIG_ALL_PPC" = "y" ]; then
  bool 'PReP bootloader kernel arguments' CONFIG_CMDLINE_BOOL y
  if [ "$CONFIG_CMDLINE_BOOL" = "y" ] ; then
    string 'Initial kernel command string' CONFIG_CMDLINE console=ttyS0,9600 console=tty0 root=/dev/sda2
  fi
fi

if [ "$CONFIG_APUS" = "y" ]; then
  define_bool CONFIG_FB_CONSOLE y
  define_bool CONFIG_AMIGA y
  define_bool CONFIG_ZORRO y
  define_bool CONFIG_AMIGAMOUSE y
  define_bool CONFIG_ABSTRACT_CONSOLE y
  define_bool CONFIG_FB y
  tristate 'Amiga builtin serial support' CONFIG_AMIGA_BUILTIN_SERIAL
  tristate 'Parallel printer support' CONFIG_M68K_PRINTER
  tristate 'GVP IO-Extender support' CONFIG_GVPIOEXT
  dep_tristate 'GVP IO-Extender parallel printer support' CONFIG_GVPIOEXT_LP $CONFIG_GVPIOEXT
  dep_tristate 'GVP IO-Extender PLIP support' CONFIG_GVPIOEXT_PLIP $CONFIG_GVPIOEXT
  tristate 'Multiface Card III serial support' CONFIG_MULTIFACE_III_TTY
  if [ "$CONFIG_AMIGA_BUILTIN_SERIAL" = "y" -o "$CONFIG_GVPIOEXT" = "y" -o \
       "$CONFIG_MULTIFACE_III_TTY" = "y" ]; then
    bool 'Support for serial port console' CONFIG_SERIAL_CONSOLE
  fi
  bool 'Use power LED as a heartbeat' CONFIG_HEARTBEAT
  bool '/proc/hardware support' CONFIG_PROC_HARDWARE
fi

endmenu

source drivers/pnp/Config.in
source drivers/block/Config.in
#source drivers.new/Config.in

if [ "$CONFIG_NET" = "y" ]; then
  source net/Config.in
fi

mainmenu_option next_comment
comment 'ATA/IDE/MFM/RLL support'

tristate 'ATA/IDE/MFM/RLL support' CONFIG_IDE

if [ "$CONFIG_IDE" != "n" ]; then
  source drivers/ide/Config.in
else
  define_bool CONFIG_BLK_DEV_IDE_MODES n
  define_bool CONFIG_BLK_DEV_HD n
fi
endmenu

mainmenu_option next_comment
comment 'SCSI support'
tristate 'SCSI support' CONFIG_SCSI
if [ "$CONFIG_SCSI" != "n" ]; then
  source drivers/scsi/Config.in
fi
endmenu

source drivers/ieee1394/Config.in

if [ "$CONFIG_NET" = "y" ]; then
  mainmenu_option next_comment
  comment 'Network device support'

  bool 'Network device support' CONFIG_NETDEVICES
  if [ "$CONFIG_NETDEVICES" = "y" ]; then
    source drivers/net/Config.in
    if [ "$CONFIG_ATM" = "y" ]; then
      source drivers/atm/Config.in
    fi
  fi
  endmenu
fi

source net/ax25/Config.in

mainmenu_option next_comment
comment 'ISDN subsystem'

tristate 'ISDN support' CONFIG_ISDN
if [ "$CONFIG_ISDN" != "n" ]; then
  source drivers/isdn/Config.in
fi
endmenu

mainmenu_option next_comment
comment 'Old CD-ROM drivers (not SCSI, not IDE)'

bool 'Support non-SCSI/IDE/ATAPI CDROM drives' CONFIG_CD_NO_IDESCSI
if [ "$CONFIG_CD_NO_IDESCSI" != "n" ]; then
  source drivers/cdrom/Config.in
fi
endmenu

mainmenu_option next_comment
comment 'Console drivers'
source drivers/video/Config.in
endmenu

source drivers/char/Config.in
source drivers/usb/Config.in
source fs/Config.in

mainmenu_option next_comment
comment 'Sound'
tristate 'Sound card support' CONFIG_SOUND
if [ "$CONFIG_SOUND" != "n" ]; then
  dep_tristate 'Amiga or PowerMac DMA sound support' CONFIG_DMASOUND $CONFIG_SOUND
  source drivers/sound/Config.in
fi

endmenu

if [ "$CONFIG_8xx" = "y" ]; then
source arch/ppc/8xx_io/Config.in
fi

mainmenu_option next_comment
comment 'Kernel hacking'

bool 'Magic SysRq key' CONFIG_MAGIC_SYSRQ
bool 'Include kgdb kernel debugger' CONFIG_KGDB
bool 'Include xmon kernel debugger' CONFIG_XMON
endmenu
```

## arch/ppc/configs/walnut_defconfig
```kconfig
#
# Default configuration for the IBM PowerPC 405GP "Walnut" evaluation board.
#

#
# Platform support
#
CONFIG_PPC=y
CONFIG_4xx=y
# CONFIG_6xx is not set
# CONFIG_PPC64 is not set
# CONFIG_82xx is not set
# CONFIG_8xx is not set
CONFIG_403=y
# CONFIG_405 is not set
CONFIG_OAK=y
# CONFIG_SMP is not set
CONFIG_MACH_SPECIFIC=y
# CONFIG_MATH_EMULATION is not set

#
# General setup
#
# CONFIG_EXPERIMENTAL is not set
CONFIG_MODULES=y
# CONFIG_MODVERSIONS is not set
CONFIG_KMOD=y
CONFIG_PCI=y
CONFIG_NET=y
CONFIG_SYSCTL=y
CONFIG_SYSVIPC=y
# CONFIG_BSD_PROCESS_ACCT is not set
CONFIG_BINFMT_ELF=y
CONFIG_KERNEL_ELF=y
CONFIG_BINFMT_MISC=y

#
# PCMCIA/CardBus support
#
# CONFIG_PCMCIA is not set
# CONFIG_PARPORT is not set
# CONFIG_VGA_CONSOLE is not set
# CONFIG_FB is not set
# CONFIG_PMAC_PBOOK is not set
# CONFIG_MAC_FLOPPY is not set
# CONFIG_MAC_SERIAL is not set
# CONFIG_ADB is not set
# CONFIG_PROC_DEVICETREE is not set
# CONFIG_TOTALMP is not set
# CONFIG_BOOTX_TEXT is not set
# CONFIG_MOTOROLA_HOTSWAP is not set

#
# Plug and Play configuration
#
# CONFIG_PNP is not set
# CONFIG_ISAPNP is not set

#
# Block devices
#
# CONFIG_BLK_DEV_FD is not set
# CONFIG_BLK_DEV_IDE is not set

#
# Please see Documentation/ide.txt for help/info on IDE drives
#
# CONFIG_BLK_DEV_HD_ONLY is not set
# CONFIG_BLK_CPQ_DA is not set

#
# Additional Block Devices
#
CONFIG_BLK_DEV_LOOP=y
# CONFIG_BLK_DEV_NBD is not set
# CONFIG_BLK_DEV_MD is not set
CONFIG_BLK_DEV_RAM=y
CONFIG_BLK_DEV_INITRD=y
# CONFIG_BLK_DEV_XD is not set
# CONFIG_BLK_DEV_DAC960 is not set
CONFIG_PARIDE_PARPORT=y
# CONFIG_PARIDE is not set
# CONFIG_BLK_DEV_IDE_MODES is not set
# CONFIG_BLK_DEV_HD is not set

#
# Networking options
#
# CONFIG_PACKET is not set
# CONFIG_NETLINK is not set
# CONFIG_NETFILTER is not set
# CONFIG_FILTER is not set
CONFIG_UNIX=y
CONFIG_INET=y
CONFIG_IP_MULTICAST=y
# CONFIG_IP_ADVANCED_ROUTER is not set
CONFIG_IP_PNP=y
CONFIG_IP_PNP_BOOTP=y
CONFIG_IP_PNP_RARP=y
# CONFIG_IP_ROUTER is not set
# CONFIG_NET_IPIP is not set
# CONFIG_NET_IPGRE is not set
# CONFIG_IP_MROUTE is not set
CONFIG_IP_ALIAS=y
CONFIG_SYN_COOKIES=y

#
# (it is safe to leave these untouched)
#
# CONFIG_SKB_LARGE is not set

#
#  
#
# CONFIG_IPX is not set
# CONFIG_ATALK is not set

#
# SCSI support
#
# CONFIG_SCSI is not set

#
# Network device support
#
CONFIG_NETDEVICES=y

#
# ARCnet devices
#
# CONFIG_ARCNET is not set
# CONFIG_DUMMY is not set
# CONFIG_EQUALIZER is not set
# CONFIG_NET_SB1000 is not set

#
# Ethernet (10 or 100Mbit)
#
CONFIG_NET_ETHERNET=y
# CONFIG_MACE is not set
# CONFIG_BMAC is not set
# CONFIG_NCR885E is not set
# CONFIG_NET_VENDOR_3COM is not set
# CONFIG_LANCE is not set
# CONFIG_NET_VENDOR_SMC is not set
# CONFIG_NET_VENDOR_RACAL is not set
# CONFIG_DEPCA is not set
# CONFIG_NET_ISA is not set
# CONFIG_NET_EISA is not set
# CONFIG_NET_POCKET is not set
# CONFIG_FDDI is not set
# CONFIG_PPP is not set
# CONFIG_SLIP is not set

#
# Wireless LAN (non-hamradio)
#
# CONFIG_NET_RADIO is not set

#
# Token Ring driver support
#
# CONFIG_TR is not set
# CONFIG_NET_FC is not set

#
# Wan interfaces
#
# CONFIG_WAN is not set

#
# Amateur Radio support
#
# CONFIG_HAMRADIO is not set

#
# ISDN subsystem
#
# CONFIG_ISDN is not set

#
# Old CD-ROM drivers (not SCSI, not IDE)
#
# CONFIG_CD_NO_IDESCSI is not set

#
# Console drivers
#

#
# Frame-buffer support
#
# CONFIG_FB is not set

#
# Character devices
#
# CONFIG_VT is not set
CONFIG_SERIAL=y
CONFIG_SERIAL_CONSOLE=y
# CONFIG_SERIAL_EXTENDED is not set
# CONFIG_SERIAL_NONSTANDARD is not set
# CONFIG_UNIX98_PTYS is not set

#
# Mice
#
# CONFIG_BUSMOUSE is not set
# CONFIG_MOUSE is not set
# CONFIG_QIC02_TAPE is not set
# CONFIG_WATCHDOG is not set
# CONFIG_NVRAM is not set
# CONFIG_RTC is not set

#
# Video For Linux
#
# CONFIG_VIDEO_DEV is not set

#
# Joystick support
#
# CONFIG_JOYSTICK is not set
# CONFIG_DTLK is not set
# CONFIG_R3964 is not set
# CONFIG_APPLICOM is not set

#
# Ftape, the floppy tape device driver
#
# CONFIG_FTAPE is not set

#
# USB drivers - not for the faint of heart
#
# CONFIG_USB is not set

#
# Filesystems
#
# CONFIG_QUOTA is not set
CONFIG_AUTOFS_FS=y
# CONFIG_AFFS_FS is not set
# CONFIG_HFS_FS is not set
# CONFIG_FAT_FS is not set
# CONFIG_MSDOS_FS is not set
# CONFIG_UMSDOS_FS is not set
# CONFIG_VFAT_FS is not set
# CONFIG_ISO9660_FS is not set
# CONFIG_JOLIET is not set
# CONFIG_UDF_FS is not set
# CONFIG_MINIX_FS is not set
# CONFIG_NTFS_FS is not set
# CONFIG_HPFS_FS is not set
CONFIG_PROC_FS=y
CONFIG_ROMFS_FS=y
CONFIG_EXT2_FS=y
# CONFIG_SYSV_FS is not set
# CONFIG_UFS_FS is not set

#
# Network File Systems
#
# CONFIG_CODA_FS is not set
CONFIG_NFS_FS=y
CONFIG_ROOT_NFS=y
# CONFIG_NFSD is not set
CONFIG_SUNRPC=y
CONFIG_LOCKD=y
# CONFIG_SMB_FS is not set
# CONFIG_NCP_FS is not set

#
# Partition Types
#
# CONFIG_PARTITION_ADVANCED is not set
CONFIG_MAC_PARTITION=y
CONFIG_MSDOS_PARTITION=y
# CONFIG_SGI_PARTITION is not set
# CONFIG_SUN_PARTITION is not set
# CONFIG_NLS is not set

#
# Sound
#
# CONFIG_SOUND is not set

#
# Kernel hacking
#
# CONFIG_MAGIC_SYSRQ is not set
# CONFIG_KGDB is not set
# CONFIG_XMON is not set
```
