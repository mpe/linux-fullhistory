## arch/alpha/config.in
```kconfig
#
# For a description of the syntax of this configuration file,
# see the Configure script.
#
mainmenu_name "Kernel configuration of Linux for Alpha machines"

mainmenu_option next_comment
comment 'Code maturity level options'
bool 'Prompt for development and/or incomplete code/drivers' CONFIG_EXPERIMENTAL
endmenu

mainmenu_option next_comment
comment 'Loadable module support'
bool 'Enable loadable module support' CONFIG_MODULES
if [ "$CONFIG_MODULES" = "y" ]; then
  bool 'Set version information on all symbols for modules' CONFIG_MODVERSIONS
  bool 'Kernel module loader' CONFIG_KMOD
fi
endmenu

mainmenu_option next_comment
comment 'General setup'

choice 'Alpha system type' \
	"Generic		CONFIG_ALPHA_GENERIC		\
	 Alcor/Alpha-XLT	CONFIG_ALPHA_ALCOR		\
	 Alpha-XL		CONFIG_ALPHA_XL			\
	 AlphaBook1		CONFIG_ALPHA_BOOK1		\
	 Avanti			CONFIG_ALPHA_AVANTI		\
	 Cabriolet		CONFIG_ALPHA_CABRIOLET		\
	 DP264			CONFIG_ALPHA_DP264		\
	 EB164			CONFIG_ALPHA_EB164		\
	 EB64+			CONFIG_ALPHA_EB64P		\
	 EB66			CONFIG_ALPHA_EB66		\
	 EB66+			CONFIG_ALPHA_EB66P		\
	 Jensen			CONFIG_ALPHA_JENSEN		\
	 LX164			CONFIG_ALPHA_LX164		\
	 Miata			CONFIG_ALPHA_MIATA		\
	 Mikasa			CONFIG_ALPHA_MIKASA		\
	 Noname			CONFIG_ALPHA_NONAME		\
	 Noritake		CONFIG_ALPHA_NORITAKE		\
	 PC164			CONFIG_ALPHA_PC164		\
	 Platform2000		CONFIG_ALPHA_P2K		\
	 Rawhide		CONFIG_ALPHA_RAWHIDE		\
	 Ruffian		CONFIG_ALPHA_RUFFIAN		\
	 RX164			CONFIG_ALPHA_RX164		\
	 SX164			CONFIG_ALPHA_SX164		\
	 Sable			CONFIG_ALPHA_SABLE		\
	 Takara			CONFIG_ALPHA_TAKARA" Generic

# clear all implied options (don't want default values for those):
unset CONFIG_ALPHA_EV4 CONFIG_ALPHA_EV5 CONFIG_ALPHA_EV6
unset CONFIG_PCI CONFIG_ALPHA_EISA
unset CONFIG_ALPHA_LCA CONFIG_ALPHA_APECS CONFIG_ALPHA_CIA
unset CONFIG_ALPHA_T2 CONFIG_ALPHA_PYXIS CONFIG_ALPHA_POLARIS
unset CONFIG_ALPHA_TSUNAMI CONFIG_ALPHA_MCPCIA
unset CONFIG_ALPHA_NEED_ROUNDING_EMULATION

if [ "$CONFIG_ALPHA_GENERIC" = "y" ]
then
	define_bool CONFIG_PCI y
	define_bool CONFIG_ALPHA_NEED_ROUNDING_EMULATION y
fi
if [ "$CONFIG_ALPHA_BOOK1" = "y" ]
then
	define_bool CONFIG_ALPHA_NONAME y
fi
if [ "$CONFIG_ALPHA_NONAME" = "y" -o "$CONFIG_ALPHA_EB66" = "y" \
	-o "$CONFIG_ALPHA_EB66P" = "y" -o "$CONFIG_ALPHA_P2K" = "y" ]
then
	define_bool CONFIG_PCI y
	define_bool CONFIG_ALPHA_EV4 y
	define_bool CONFIG_ALPHA_LCA y
fi
if [ "$CONFIG_ALPHA_CABRIOLET" = "y" -o "$CONFIG_ALPHA_AVANTI" = "y" \
	-o "$CONFIG_ALPHA_EB64P" = "y" -o "$CONFIG_ALPHA_XL" = "y" ]
then
	define_bool CONFIG_PCI y
	define_bool CONFIG_ALPHA_EV4 y
	define_bool CONFIG_ALPHA_APECS y
fi
if [ "$CONFIG_ALPHA_EB164" = "y" -o "$CONFIG_ALPHA_PC164" = "y" \
	-o "$CONFIG_ALPHA_ALCOR" = "y" -o "$CONFIG_ALPHA_XLT" = "y" \
	-o "$CONFIG_ALPHA_TAKARA" = "y" ]
then
	define_bool CONFIG_PCI y
	define_bool CONFIG_ALPHA_EV5 y
	define_bool CONFIG_ALPHA_CIA y
fi
if [ "$CONFIG_ALPHA_MIKASA" = "y" -o "$CONFIG_ALPHA_NORITAKE" = "y" ]
then
	bool 'EV5 CPU daughtercard (model 5/xxx)?' CONFIG_ALPHA_PRIMO
	if [ "$CONFIG_ALPHA_PRIMO" = "y" ]
	then
		define_bool CONFIG_ALPHA_EV5 y
		define_bool CONFIG_ALPHA_CIA y
	else
		define_bool CONFIG_ALPHA_EV4 y
		define_bool CONFIG_ALPHA_APECS y
	fi
	define_bool CONFIG_PCI y
fi
if [ "$CONFIG_ALPHA_SABLE" = "y" ]
then
	define_bool CONFIG_PCI y
	bool 'EV5 CPU(s) (model 5/xxx)?' CONFIG_ALPHA_GAMMA
	if [ "$CONFIG_ALPHA_GAMMA" = "y" ]
	then
		define_bool CONFIG_ALPHA_EV5 y
	else
	define_bool CONFIG_ALPHA_EV4 y
	fi
	define_bool CONFIG_ALPHA_T2 y
fi
if [ "$CONFIG_ALPHA_MIATA" = "y" -o "$CONFIG_ALPHA_LX164" = "y" \
	-o "$CONFIG_ALPHA_SX164" = "y" -o "$CONFIG_ALPHA_RUFFIAN" = "y" ]
then
	define_bool CONFIG_PCI y
	define_bool CONFIG_ALPHA_EV5 y
	define_bool CONFIG_ALPHA_PYXIS y
fi
if [ "$CONFIG_ALPHA_DP264" = "y" ]
then
	define_bool CONFIG_PCI y
	define_bool CONFIG_ALPHA_EV6 y
	define_bool CONFIG_ALPHA_TSUNAMI y
fi
if [ "$CONFIG_ALPHA_RAWHIDE" = "y" ]
then
	define_bool CONFIG_PCI y
	define_bool CONFIG_ALPHA_EV5 y
	define_bool CONFIG_ALPHA_MCPCIA y
fi
if [ "$CONFIG_ALPHA_RX164" = "y" ]
then
	define_bool CONFIG_PCI y
	define_bool CONFIG_ALPHA_EV5 y
	define_bool CONFIG_ALPHA_POLARIS y
fi
if [ "$CONFIG_ALPHA_JENSEN" = "y" ]
then
	define_bool CONFIG_ALPHA_EV4 y
fi
if [ "$CONFIG_ALPHA_EV4" = "y" ]
then
	# EV45 and older do not support all rounding modes in hw:
	define_bool CONFIG_ALPHA_NEED_ROUNDING_EMULATION y
fi

if [ "$CONFIG_ALPHA_CABRIOLET" = "y" -o "$CONFIG_ALPHA_AVANTI" = "y" \
	-o "$CONFIG_ALPHA_EB64P" = "y" -o "$CONFIG_ALPHA_JENSEN" = "y" \
	-o "$CONFIG_ALPHA_MIKASA" = "y" -o "$CONFIG_ALPHA_ALCOR" = "y" \
	-o "$CONFIG_ALPHA_SABLE" = "y" -o "$CONFIG_ALPHA_MIATA" = "y" \
	-o "$CONFIG_ALPHA_NORITAKE" = "y" -o "$CONFIG_ALPHA_PC164" = "y" \
	-o "$CONFIG_ALPHA_LX164" = "y" -o "$CONFIG_ALPHA_SX164" = "y" \
	-o "$CONFIG_ALPHA_DP264" = "y" -o "$CONFIG_ALPHA_RAWHIDE" = "y" ]
then
  bool 'Use SRM as bootloader' CONFIG_ALPHA_SRM
  if [ "$CONFIG_EXPERIMENTAL" = "y" ]; then
    if [ "$CONFIG_ALPHA_SRM" = "y" ]; then
      bool '  Use SRM PCI setup' CONFIG_ALPHA_SRM_SETUP
    fi
  fi
fi
if [ "$CONFIG_ALPHA_ALCOR" = "y" -o "$CONFIG_ALPHA_MIKASA" = "y" \
	-o "$CONFIG_ALPHA_SABLE" = "y" -o "$CONFIG_ALPHA_NORITAKE" = "y" \
	-o "$CONFIG_ALPHA_RAWHIDE" = "y" ]
then
	define_bool CONFIG_ALPHA_EISA y
fi
if [ "$CONFIG_ALPHA_XL" = "y" ]
then
	define_bool CONFIG_ALPHA_AVANTI y
fi

bool 'Symmetric multi-processing support' CONFIG_SMP

if [ "$CONFIG_PCI" = "y" ]; then
  bool 'PCI quirks' CONFIG_PCI_QUIRKS
  if [ "$CONFIG_PCI_QUIRKS" = "y" -a "$CONFIG_EXPERIMENTAL" = "y" ]; then
    bool 'PCI bridge optimization (experimental)' CONFIG_PCI_OPTIMIZE
  fi
  bool 'Backward-compatible /proc/pci' CONFIG_PCI_OLD_PROC
fi
bool 'Networking support' CONFIG_NET
bool 'System V IPC' CONFIG_SYSVIPC
bool 'BSD Process Accounting' CONFIG_BSD_PROCESS_ACCT
bool 'Sysctl support' CONFIG_SYSCTL
tristate 'Kernel support for a.out (ECOFF) binaries' CONFIG_BINFMT_AOUT
tristate 'Kernel support for ELF binaries' CONFIG_BINFMT_ELF
tristate 'Kernel support for MISC binaries' CONFIG_BINFMT_MISC
if [ "$CONFIG_EXPERIMENTAL" = "y" ]; then
  tristate 'Kernel support for JAVA binaries (obsolete)' CONFIG_BINFMT_JAVA
fi
tristate 'Kernel support for Linux/Intel ELF binaries' CONFIG_BINFMT_EM86
tristate 'Parallel port support' CONFIG_PARPORT
if [ "$CONFIG_PARPORT" != "n" ]; then
  dep_tristate '  PC-style hardware' CONFIG_PARPORT_PC $CONFIG_PARPORT
  if [ "$CONFIG_PARPORT_PC" != "n" ]; then
    bool '   Support foreign hardware' CONFIG_PARPORT_OTHER
  fi
fi
endmenu

source drivers/pnp/Config.in

source drivers/block/Config.in

if [ "$CONFIG_NET" = "y" ]; then
  source net/Config.in
fi

mainmenu_option next_comment
comment 'SCSI support'

tristate 'SCSI support' CONFIG_SCSI

if [ "$CONFIG_SCSI" != "n" ]; then
  source drivers/scsi/Config.in
fi
endmenu

if [ "$CONFIG_NET" = "y" ]; then
  mainmenu_option next_comment
  comment 'Network device support'

  bool 'Network device support' CONFIG_NETDEVICES
  if [ "$CONFIG_NETDEVICES" = "y" ]; then
    source drivers/net/Config.in
  fi
  endmenu
fi

source net/ax25/Config.in

mainmenu_option next_comment
comment 'ISDN subsystem'

tristate 'ISDN support' CONFIG_ISDN
if [ "$CONFIG_ISDN" != "n" ]; then
  source drivers/isdn/Config.in
fi
endmenu

mainmenu_option next_comment
comment 'CD-ROM drivers (not for SCSI or IDE/ATAPI drives)'

bool 'Support non-SCSI/IDE/ATAPI drives' CONFIG_CD_NO_IDESCSI
if [ "$CONFIG_CD_NO_IDESCSI" != "n" ]; then
  source drivers/cdrom/Config.in
fi
endmenu

source drivers/char/Config.in

source fs/Config.in

if [ "$CONFIG_VT" = "y" ]; then
  mainmenu_option next_comment
  comment 'Console drivers'
  bool 'VGA text console' CONFIG_VGA_CONSOLE
  bool 'Support for frame buffer devices' CONFIG_FB
  if [ "$CONFIG_FB" = "y" ]; then
    define_bool CONFIG_PCI_CONSOLE y
  fi
  source drivers/video/Config.in
  endmenu
fi

mainmenu_option next_comment
comment 'Sound'

tristate 'Sound card support' CONFIG_SOUND
if [ "$CONFIG_SOUND" != "n" ]; then
  source drivers/sound/Config.in
fi
endmenu

mainmenu_option next_comment
comment 'Kernel hacking'

#bool 'Debug kmalloc/kfree' CONFIG_DEBUG_MALLOC
if [ "$CONFIG_EXPERIMENTAL" = "y" ]; then
  tristate 'Kernel FP software completion' CONFIG_MATHEMU
else
  define_bool CONFIG_MATHEMU y
fi

bool 'Magic SysRq key' CONFIG_MAGIC_SYSRQ
endmenu
```
