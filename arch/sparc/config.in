## arch/sparc/config.in
```kconfig
# $Id: config.in,v 1.63 1998/09/21 05:05:56 jj Exp $
# For a description of the syntax of this configuration file,
# see the Configure script.
#
mainmenu_name "Linux/SPARC Kernel Configuration"

mainmenu_option next_comment
comment 'Code maturity level options'
bool 'Prompt for development and/or incomplete code/drivers' CONFIG_EXPERIMENTAL
endmenu

mainmenu_option next_comment
comment 'Loadable module support'
bool 'Enable loadable module support' CONFIG_MODULES
if [ "$CONFIG_MODULES" = "y" ]; then
  bool 'Set version information on all symbols for modules' CONFIG_MODVERSIONS
  bool 'Kernel module loader' CONFIG_KMOD
fi
endmenu

mainmenu_option next_comment
comment 'General setup'

define_bool CONFIG_VT y
define_bool CONFIG_VT_CONSOLE y

bool 'Support for AP1000 multicomputer' CONFIG_AP1000
bool 'Symmetric multi-processing support' CONFIG_SMP

if [ "$CONFIG_AP1000" = "y" ]; then
	define_bool CONFIG_NO_KEYBOARD y
	define_bool CONFIG_FDDI y
	define_bool CONFIG_APFDDI y
	define_bool CONFIG_APBLOCK y
	define_bool CONFIG_APBIF y
	tristate 'OPIU DDV Driver' CONFIG_DDV
else
	bool 'Support for SUN4 machines (disables SUN4[CDM] support)' CONFIG_SUN4
	if [ "$CONFIG_SUN4" != "y" ]; then
		bool 'Support for PCI and PS/2 keyboard/mouse' CONFIG_PCI
	fi

	mainmenu_option next_comment
	comment 'Console drivers'
	bool 'PROM console' CONFIG_PROM_CONSOLE
	bool 'Support Frame buffer devices' CONFIG_FB
	source drivers/video/Config.in
	endmenu

	# Global things across all Sun machines.
	define_bool CONFIG_SBUS y
	define_bool CONFIG_SBUSCHAR y
	define_bool CONFIG_SUN_MOUSE y
	define_bool CONFIG_SERIAL y
	define_bool CONFIG_SUN_SERIAL y
	define_bool CONFIG_SERIAL_CONSOLE y
	define_bool CONFIG_SUN_KEYBOARD y
	define_bool CONFIG_SUN_CONSOLE y
	define_bool CONFIG_SUN_AUXIO y
	define_bool CONFIG_SUN_IO y
	if [ "$CONFIG_SUN4" != "y" ]; then
		source drivers/sbus/char/Config.in
		source drivers/sbus/audio/Config.in
	fi
fi

tristate 'Openprom tree appears in /proc/openprom (EXPERIMENTAL)' CONFIG_SUN_OPENPROMFS
bool 'Networking support' CONFIG_NET
bool 'System V IPC' CONFIG_SYSVIPC
bool 'BSD Process Accounting' CONFIG_BSD_PROCESS_ACCT
bool 'Sysctl support' CONFIG_SYSCTL
tristate 'Kernel support for a.out binaries' CONFIG_BINFMT_AOUT
tristate 'Kernel support for ELF binaries' CONFIG_BINFMT_ELF
tristate 'Kernel support for MISC binaries' CONFIG_BINFMT_MISC
if [ "$CONFIG_EXPERIMENTAL" = "y" ]; then
  tristate 'Kernel support for JAVA binaries (obsolete)' CONFIG_BINFMT_JAVA
fi
endmenu

mainmenu_option next_comment
comment 'Floppy, IDE, and other block devices'

bool 'Normal floppy disk support' CONFIG_BLK_DEV_FD

bool 'Multiple devices driver support' CONFIG_BLK_DEV_MD
if [ "$CONFIG_BLK_DEV_MD" = "y" ]; then
  tristate '   Linear (append) mode' CONFIG_MD_LINEAR
  tristate '   RAID-0 (striping) mode' CONFIG_MD_STRIPED
  tristate '   RAID-1 (mirroring) mode' CONFIG_MD_MIRRORING
  tristate '   RAID-4/RAID-5 mode' CONFIG_MD_RAID5
fi

tristate 'RAM disk support' CONFIG_BLK_DEV_RAM
if [ "$CONFIG_BLK_DEV_RAM" = "y" ]; then
  bool '   Initial RAM disk (initrd) support' CONFIG_BLK_DEV_INITRD
fi

tristate 'Loopback device support' CONFIG_BLK_DEV_LOOP
tristate 'Network block device support' CONFIG_BLK_DEV_NBD

endmenu

if [ "$CONFIG_NET" = "y" ]; then
	source net/Config.in
fi

mainmenu_option next_comment
comment 'ISDN subsystem'

tristate 'ISDN support' CONFIG_ISDN
if [ "$CONFIG_ISDN" != "n" ]; then
  source drivers/isdn/Config.in
fi
endmenu

mainmenu_option next_comment
comment 'SCSI support'

tristate 'SCSI support' CONFIG_SCSI

if [ "$CONFIG_SCSI" != "n" ]; then
	comment 'SCSI support type (disk, tape, CDrom)'

	dep_tristate 'SCSI disk support' CONFIG_BLK_DEV_SD $CONFIG_SCSI
	dep_tristate 'SCSI tape support' CONFIG_CHR_DEV_ST $CONFIG_SCSI
	dep_tristate 'SCSI CDROM support' CONFIG_BLK_DEV_SR $CONFIG_SCSI
	if [ "$CONFIG_BLK_DEV_SR" != "n" ]; then
	  bool '  Enable vendor-specific extensions (for SCSI CDROM)' CONFIG_BLK_DEV_SR_VENDOR
	fi
	dep_tristate 'SCSI generic support' CONFIG_CHR_DEV_SG $CONFIG_SCSI

	comment 'Some SCSI devices (e.g. CD jukebox) support multiple LUNs'

	bool 'Probe all LUNs on each SCSI device' CONFIG_SCSI_MULTI_LUN

	bool 'Verbose SCSI error reporting (kernel size +=12K)' CONFIG_SCSI_CONSTANTS

	mainmenu_option next_comment
	comment 'SCSI low-level drivers'

	bool 'Sparc ESP Scsi Driver' CONFIG_SCSI_SUNESP $CONFIG_SCSI
	tristate 'PTI Qlogic,ISP Driver' CONFIG_SCSI_QLOGICPTI $CONFIG_SCSI
	endmenu
fi
endmenu

source drivers/fc4/Config.in

if [ "$CONFIG_NET" = "y" ]; then
	mainmenu_option next_comment
	comment 'Network device support'

	bool 'Network device support' CONFIG_NETDEVICES
	if [ "$CONFIG_NETDEVICES" = "y" ]; then
		tristate 'Dummy net driver support' CONFIG_DUMMY
		tristate 'PPP (point-to-point) support' CONFIG_PPP
		if [ ! "$CONFIG_PPP" = "n" ]; then
		   comment 'CCP compressors for PPP are only built as modules.'
		fi
		tristate 'SLIP (serial line) support' CONFIG_SLIP
		if [ "$CONFIG_SLIP" != "n" ]; then
		  bool ' CSLIP compressed headers' CONFIG_SLIP_COMPRESSED
		  bool ' Keepalive and linefill' CONFIG_SLIP_SMART
		  bool ' Six bit SLIP encapsulation' CONFIG_SLIP_MODE_SLIP6
		fi
		tristate 'Sun LANCE support' CONFIG_SUNLANCE
		tristate 'Sun Happy Meal 10/100baseT support' CONFIG_HAPPYMEAL
		tristate 'Sun QuadEthernet support' CONFIG_SUNQE
		tristate 'MyriCOM Gigabit Ethernet support' CONFIG_MYRI_SBUS
#		bool 'FDDI driver support' CONFIG_FDDI
#		if [ "$CONFIG_FDDI" = "y" ]; then
#		fi
	fi
	endmenu
fi

source fs/Config.in

mainmenu_option next_comment
comment 'Watchdog'

tristate 'Software watchdog' CONFIG_SOFT_WATCHDOG
endmenu

mainmenu_option next_comment
comment 'Kernel hacking'

bool 'Magic SysRq key' CONFIG_MAGIC_SYSRQ
endmenu
```

## arch/sparc64/config.in
```kconfig
# $Id: config.in,v 1.58 1998/11/16 04:47:30 davem Exp $
# For a description of the syntax of this configuration file,
# see the Configure script.
#
mainmenu_name "Linux/SPARC Kernel Configuration"

mainmenu_option next_comment
comment 'Code maturity level options'
bool 'Prompt for development and/or incomplete code/drivers' CONFIG_EXPERIMENTAL
endmenu

mainmenu_option next_comment
comment 'Loadable module support'
bool 'Enable loadable module support' CONFIG_MODULES
if [ "$CONFIG_MODULES" = "y" ]; then
  bool 'Set version information on all symbols for modules' CONFIG_MODVERSIONS
  bool 'Kernel module loader' CONFIG_KMOD
fi
endmenu

mainmenu_option next_comment
comment 'General setup'

define_bool CONFIG_VT y
define_bool CONFIG_VT_CONSOLE y

bool 'Support for AP1000 multicomputer' CONFIG_AP1000
bool 'Symmetric multi-processing support' CONFIG_SMP

mainmenu_option next_comment
comment 'Console drivers'
bool 'PROM console' CONFIG_PROM_CONSOLE
bool 'Support Frame buffer devices' CONFIG_FB
source drivers/video/Config.in
endmenu

if [ "$CONFIG_AP1000" = "y" ]; then
	define_bool CONFIG_NO_KEYBOARD y
	define_bool CONFIG_APFDDI y
	define_bool CONFIG_APBLOCK y
	define_bool CONFIG_APBIF y
	tristate 'OPIU DDV Driver' CONFIG_DDV
else
	# Global things across all Sun machines.
	define_bool CONFIG_SBUS y
	define_bool CONFIG_SBUSCHAR y
	define_bool CONFIG_SUN_MOUSE y
	define_bool CONFIG_SERIAL y
	define_bool CONFIG_SUN_SERIAL y
	define_bool CONFIG_SERIAL_CONSOLE y
	define_bool CONFIG_SUN_KEYBOARD y
	define_bool CONFIG_SUN_CONSOLE y
	define_bool CONFIG_SUN_AUXIO y
	define_bool CONFIG_SUN_IO y
	bool 'PCI support' CONFIG_PCI
	source drivers/sbus/char/Config.in
	source drivers/sbus/audio/Config.in
fi

tristate 'Openprom tree appears in /proc/openprom (EXPERIMENTAL)' CONFIG_SUN_OPENPROMFS
if [ "$CONFIG_PCI" = "y" ]; then
  bool 'Backward-compatible /proc/pci' CONFIG_PCI_OLD_PROC
fi
bool 'Networking support' CONFIG_NET
bool 'System V IPC' CONFIG_SYSVIPC
bool 'BSD Process Accounting' CONFIG_BSD_PROCESS_ACCT
bool 'Sysctl support' CONFIG_SYSCTL
bool 'Kernel support for Linux/Sparc 32bit binary compatibility' CONFIG_SPARC32_COMPAT
tristate 'Kernel support for 64-bit ELF binaries' CONFIG_BINFMT_ELF
if [ "$CONFIG_SPARC32_COMPAT" != "n" ]; then
  tristate 'Kernel support for 32-bit ELF binaries' CONFIG_BINFMT_ELF32
  bool 'Kernel support for 32-bit (ie. SunOS) a.out binaries' CONFIG_BINFMT_AOUT32
fi
if [ "$CONFIG_EXPERIMENTAL" = "y" ]; then
  tristate 'Kernel support for MISC binaries' CONFIG_BINFMT_MISC
  tristate 'Kernel support for JAVA binaries (obsolete)' CONFIG_BINFMT_JAVA
fi
if [ "$CONFIG_EXPERIMENTAL" = "y" ]; then
  tristate 'Solaris binary emulation' CONFIG_SOLARIS_EMUL
fi

if [ "$CONFIG_PCI" = "y" ]; then
  tristate 'Parallel port support' CONFIG_PARPORT
  if [ "$CONFIG_PARPORT" != "n" ]; then
    dep_tristate '  Ultra/AX-style hardware' CONFIG_PARPORT_AX $CONFIG_PARPORT
    if [ "$CONFIG_PARPORT_AX" = "m" ]; then
      define_bool CONFIG_PARPORT_LOWLEVEL_MODULE y
    fi
    if [ "$CONFIG_PARPORT_AX" != "n" ]; then
      bool '  Support foreign hardware' CONFIG_PARPORT_OTHER
    fi
    dep_tristate '  Parallel printer support' CONFIG_PRINTER $CONFIG_PARPORT
    if [ "$CONFIG_PRINTER" != "n" ]; then
      bool '    Support IEEE1284 status readback' CONFIG_PRINTER_READBACK
    fi
  fi
  tristate 'SUNW,envctrl support' CONFIG_ENVCTRL
fi
endmenu

mainmenu_option next_comment
comment 'Floppy, IDE, and other block devices'

bool 'Normal floppy disk support' CONFIG_BLK_DEV_FD

bool 'Multiple devices driver support' CONFIG_BLK_DEV_MD
if [ "$CONFIG_BLK_DEV_MD" = "y" ]; then
  tristate '   Linear (append) mode' CONFIG_MD_LINEAR
  tristate '   RAID-0 (striping) mode' CONFIG_MD_STRIPED
  tristate '   RAID-1 (mirroring) mode' CONFIG_MD_MIRRORING
  tristate '   RAID-4/RAID-5 mode' CONFIG_MD_RAID5
fi

tristate 'RAM disk support' CONFIG_BLK_DEV_RAM
if [ "$CONFIG_BLK_DEV_RAM" = "y" ]; then
  bool '   Initial RAM disk (initrd) support' CONFIG_BLK_DEV_INITRD
fi

tristate 'Loopback device support' CONFIG_BLK_DEV_LOOP
tristate 'Network block device support' CONFIG_BLK_DEV_NBD

if [ "$CONFIG_PCI" = "y" ]; then
	tristate 'Ultra/PCI IDE disk/cdrom/tape/floppy support' CONFIG_BLK_DEV_IDE
	if [ "$CONFIG_BLK_DEV_IDE" != "n" ]; then
	  dep_tristate '   Include IDE/ATA-2 DISK support' CONFIG_BLK_DEV_IDEDISK $CONFIG_BLK_DEV_IDE
	  dep_tristate '   Include IDE/ATAPI CDROM support' CONFIG_BLK_DEV_IDECD $CONFIG_BLK_DEV_IDE
	  dep_tristate '   Include IDE/ATAPI TAPE support' CONFIG_BLK_DEV_IDETAPE $CONFIG_BLK_DEV_IDE
	  dep_tristate '   Include IDE/ATAPI FLOPPY support' CONFIG_BLK_DEV_IDEFLOPPY $CONFIG_BLK_DEV_IDE
	  dep_tristate '   SCSI emulation support' CONFIG_BLK_DEV_IDESCSI $CONFIG_BLK_DEV_IDE
	  define_bool CONFIG_BLK_DEV_IDEPCI y
	  define_bool CONFIG_BLK_DEV_IDEDMA y
	  define_bool CONFIG_IDEDMA_AUTO y
	  define_bool CONFIG_BLK_DEV_NS87415 y
	  define_bool CONFIG_BLK_DEV_CMD646 y
	fi
fi

endmenu

if [ "$CONFIG_NET" = "y" ]; then
	source net/Config.in
fi

mainmenu_option next_comment
comment 'SCSI support'

tristate 'SCSI support' CONFIG_SCSI

if [ "$CONFIG_SCSI" != "n" ]; then
	comment 'SCSI support type (disk, tape, CDrom)'

	dep_tristate 'SCSI disk support' CONFIG_BLK_DEV_SD $CONFIG_SCSI
	dep_tristate 'SCSI tape support' CONFIG_CHR_DEV_ST $CONFIG_SCSI
	dep_tristate 'SCSI CDROM support' CONFIG_BLK_DEV_SR $CONFIG_SCSI
	if [ "$CONFIG_BLK_DEV_SR" != "n" ]; then
	  bool '  Enable vendor-specific extensions (for SCSI CDROM)' CONFIG_BLK_DEV_SR_VENDOR
	fi
	dep_tristate 'SCSI generic support' CONFIG_CHR_DEV_SG $CONFIG_SCSI

	comment 'Some SCSI devices (e.g. CD jukebox) support multiple LUNs'

	bool 'Probe all LUNs on each SCSI device' CONFIG_SCSI_MULTI_LUN

	bool 'Verbose SCSI error reporting (kernel size +=12K)' CONFIG_SCSI_CONSTANTS

	mainmenu_option next_comment
	comment 'SCSI low-level drivers'

	bool 'Sparc ESP Scsi Driver' CONFIG_SCSI_SUNESP $CONFIG_SCSI
	tristate 'PTI Qlogic,ISP Driver' CONFIG_SCSI_QLOGICPTI $CONFIG_SCSI

	if [ "$CONFIG_PCI" != "n" ]; then
	  dep_tristate 'Adaptec AIC7xxx support' CONFIG_SCSI_AIC7XXX $CONFIG_SCSI
	  if [ "$CONFIG_SCSI_AIC7XXX" != "n" ]; then
	    bool '   Enable tagged command queueing' CONFIG_AIC7XXX_TAGGED_QUEUEING Y
	    bool '   Override driver defaults for commands per LUN' CONFIG_OVERRIDE_CMDS N
	    if [ "$CONFIG_OVERRIDE_CMDS" != "n" ]; then
	      int  '   Maximum number of commands per LUN' CONFIG_AIC7XXX_CMDS_PER_LUN 8
	    fi
	    bool '   Enable SCB paging' CONFIG_AIC7XXX_PAGE_ENABLE N
	    bool '   Collect statistics to report in /proc' CONFIG_AIC7XXX_PROC_STATS N
	    int  '   Delay in seconds after SCSI bus reset' CONFIG_AIC7XXX_RESET_DELAY 15
	  fi
	  dep_tristate 'NCR53C8XX SCSI support' CONFIG_SCSI_NCR53C8XX $CONFIG_SCSI
	  if [ "$CONFIG_SCSI_NCR53C8XX" != "n" ]; then
	    int  '  default tagged command queue depth' CONFIG_SCSI_NCR53C8XX_DEFAULT_TAGS 8
	    int  '  maximum number of queued commands' CONFIG_SCSI_NCR53C8XX_MAX_TAGS 32
	    int  '  synchronous transfers frequency in MHz' CONFIG_SCSI_NCR53C8XX_SYNC 10
	    bool '  enable profiling' CONFIG_SCSI_NCR53C8XX_PROFILE
	    if [ "$CONFIG_SCSI_NCR53C8XX_DEFAULT_TAGS" = "0" ]; then
	      bool '  not allow targets to disconnect' CONFIG_SCSI_NCR53C8XX_NO_DISCONNECT
	    fi
	    if [ "$CONFIG_EXPERIMENTAL" = "y" ]; then
	      bool '  assume boards are SYMBIOS compatible' CONFIG_SCSI_NCR53C8XX_SYMBIOS_COMPAT
	    fi
	  fi
	fi

	endmenu
fi
endmenu

source drivers/fc4/Config.in

if [ "$CONFIG_NET" = "y" ]; then
	mainmenu_option next_comment
	comment 'Network device support'

	bool 'Network device support' CONFIG_NETDEVICES
	if [ "$CONFIG_NETDEVICES" = "y" ]; then
		tristate 'Dummy net driver support' CONFIG_DUMMY
		tristate 'PPP (point-to-point) support' CONFIG_PPP
		if [ ! "$CONFIG_PPP" = "n" ]; then
		   comment 'CCP compressors for PPP are only built as modules.'
		fi
		tristate 'SLIP (serial line) support' CONFIG_SLIP
		if [ "$CONFIG_SLIP" != "n" ]; then
		  bool ' CSLIP compressed headers' CONFIG_SLIP_COMPRESSED
		  bool ' Keepalive and linefill' CONFIG_SLIP_SMART
		  bool ' Six bit SLIP encapsulation' CONFIG_SLIP_MODE_SLIP6
		fi
		bool 'Sun LANCE support' CONFIG_SUNLANCE
		tristate 'Sun Happy Meal 10/100baseT support' CONFIG_HAPPYMEAL
		tristate 'Sun QuadEthernet support' CONFIG_SUNQE
		tristate 'MyriCOM Gigabit Ethernet support' CONFIG_MYRI_SBUS
		if [ "$CONFIG_PCI" = "y" ]; then
			tristate 'Generic DECchip & DIGITAL EtherWORKS PCI/EISA' CONFIG_DE4X5
# Turned off until updated 3c59x.c driver
# gets approved by Linus...  --DAVEM
#
#			tristate '3c590/3c900 series (592/595/597) "Vortex/Boomerang" support' CONFIG_VORTEX
		fi
#		bool 'FDDI driver support' CONFIG_FDDI
#		if [ "$CONFIG_FDDI" = "y" ]; then
#		fi
	fi
	endmenu
fi

source fs/Config.in

mainmenu_option next_comment
comment 'Watchdog'

tristate 'Software watchdog' CONFIG_SOFT_WATCHDOG
endmenu

mainmenu_option next_comment
comment 'Kernel hacking'

bool 'Magic SysRq key' CONFIG_MAGIC_SYSRQ
#bool 'ECache flush trap support at ta 0x72' CONFIG_EC_FLUSH_TRAP
endmenu
```
