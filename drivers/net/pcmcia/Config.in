## fs/Config.in
```kconfig
#
# Filesystem configuration
#
mainmenu_option next_comment
comment 'Filesystems'

bool 'Quota support' CONFIG_QUOTA
tristate 'Kernel automounter support' CONFIG_AUTOFS_FS
tristate 'Kernel automounter version 4 support (also supports v3)' CONFIG_AUTOFS4_FS


dep_tristate 'ADFS file system support (read only) (EXPERIMENTAL)' CONFIG_ADFS_FS $CONFIG_EXPERIMENTAL

tristate 'Amiga FFS file system support' CONFIG_AFFS_FS

dep_tristate 'Apple Macintosh file system support (EXPERIMENTAL)' CONFIG_HFS_FS $CONFIG_EXPERIMENTAL

dep_tristate 'BFS file system support (EXPERIMENTAL)' CONFIG_BFS_FS $CONFIG_EXPERIMENTAL

# msdos file systems
tristate 'DOS FAT fs support' CONFIG_FAT_FS
dep_tristate '  MSDOS fs support' CONFIG_MSDOS_FS $CONFIG_FAT_FS
dep_tristate '    UMSDOS: Unix-like file system on top of standard MSDOS fs' CONFIG_UMSDOS_FS $CONFIG_MSDOS_FS
dep_tristate '  VFAT (Windows-95) fs support' CONFIG_VFAT_FS $CONFIG_FAT_FS
dep_tristate 'EFS file system support (read only) (EXPERIMENTAL)' CONFIG_EFS_FS $CONFIG_EXPERIMENTAL

tristate 'Compressed ROM file sytem support' CONFIG_CRAMFS

tristate 'ISO 9660 CDROM file system support' CONFIG_ISO9660_FS
if [ "$CONFIG_ISO9660_FS" != "n" ]; then
   bool '  Microsoft Joliet CDROM extensions' CONFIG_JOLIET
else
   # needed by nls/Config.in
   define_bool CONFIG_JOLIET n
fi

tristate 'Minix fs support' CONFIG_MINIX_FS

tristate 'NTFS filesystem support (read only)' CONFIG_NTFS_FS
if [ "$CONFIG_NTFS_FS" != "n" -a "$CONFIG_EXPERIMENTAL" = "y" ]; then
   bool '  NTFS write support (DANGEROUS)' CONFIG_NTFS_RW
fi

tristate 'OS/2 HPFS filesystem support' CONFIG_HPFS_FS

bool '/proc filesystem support' CONFIG_PROC_FS

dep_bool '/dev filesystem support (EXPERIMENTAL)' CONFIG_DEVFS_FS $CONFIG_EXPERIMENTAL
dep_bool '  Debug devfs' CONFIG_DEVFS_DEBUG $CONFIG_DEVFS_FS

# It compiles as a module for testing only.  It should not be used
# as a module in general.  If we make this "tristate", a bunch of people
# who don't know what they are doing turn it on and complain when it
# breaks.
dep_bool '/dev/pts filesystem for Unix98 PTYs' CONFIG_DEVPTS_FS $CONFIG_UNIX98_PTYS

dep_tristate 'QNX4 filesystem support (read only) (EXPERIMENTAL)' CONFIG_QNX4FS_FS $CONFIG_EXPERIMENTAL
if [ "$CONFIG_QNX4FS_FS" != "n" -a "$CONFIG_EXPERIMENTAL" = "y" ]; then
   bool '  QNX4FS write support (DANGEROUS)' CONFIG_QNX4FS_RW
fi

tristate 'ROM filesystem support' CONFIG_ROMFS_FS

tristate 'Second extended fs support' CONFIG_EXT2_FS

tristate 'System V and Coherent filesystem support' CONFIG_SYSV_FS
if [ "$CONFIG_SYSV_FS" != "n" -a "$CONFIG_EXPERIMENTAL" = "y" ]; then
   bool '  SYSV filesystem write support (DANGEROUS)' CONFIG_SYSV_FS_WRITE
fi

tristate 'UDF filesystem support (read only)' CONFIG_UDF_FS
if [ "$CONFIG_UDF_FS" != "n" -a "$CONFIG_EXPERIMENTAL" = "y" ]; then
   bool '  UDF write support (DANGEROUS)' CONFIG_UDF_RW
fi

tristate 'UFS filesystem support (read only)' CONFIG_UFS_FS
if [ "$CONFIG_UFS_FS" != "n" -a "$CONFIG_EXPERIMENTAL" = "y" ]; then
   bool '  UFS filesystem write support (DANGEROUS)' CONFIG_UFS_FS_WRITE
fi

if [ "$CONFIG_NET" = "y" ]; then

mainmenu_option next_comment
comment 'Network File Systems'

if [ "$CONFIG_INET" = "y" ]; then
   tristate 'Coda file system support (advanced network fs)' CONFIG_CODA_FS

   tristate 'NFS file system support' CONFIG_NFS_FS
   dep_bool '  Root file system on NFS' CONFIG_ROOT_NFS $CONFIG_NFS_FS $CONFIG_IP_PNP

   tristate 'NFS server support' CONFIG_NFSD
   if [ "$CONFIG_NFSD" != "n" ]; then
      bool '  Provide NFSv3 server support (EXPERIMENTAL)' CONFIG_NFSD_V3
   fi

   if [ "$CONFIG_NFS_FS" = "y" -o "$CONFIG_NFSD" = "y" ]; then
      define_tristate CONFIG_SUNRPC y
      define_tristate CONFIG_LOCKD y
   else
      if [ "$CONFIG_NFS_FS" = "m" -o "$CONFIG_NFSD" = "m" ]; then
	 define_tristate CONFIG_SUNRPC m
	 define_tristate CONFIG_LOCKD m
   else
	 define_tristate CONFIG_SUNRPC n
	 define_tristate CONFIG_LOCKD n
      fi
   fi
   if [ "$CONFIG_NFSD_V3" == "y" ]; then
     define_bool CONFIG_LOCKD_V4 y
   fi
   tristate 'SMB file system support (to mount WfW shares etc.)' CONFIG_SMB_FS
fi
if [ "$CONFIG_IPX" != "n" -o "$CONFIG_INET" != "n" ]; then
   tristate 'NCP file system support (to mount NetWare volumes)' CONFIG_NCP_FS
   if [ "$CONFIG_NCP_FS" != "n" ]; then
      source fs/ncpfs/Config.in
   fi
fi

endmenu
fi

mainmenu_option next_comment
comment 'Partition Types'
source fs/partitions/Config.in
endmenu
source fs/nls/Config.in
endmenu
```

## net/Config.in
```kconfig
#
# Network configuration
#
mainmenu_option next_comment
comment 'Networking options'
tristate 'Packet socket' CONFIG_PACKET
bool 'Kernel/User netlink socket' CONFIG_NETLINK
if [ "$CONFIG_NETLINK" = "y" ]; then
  bool 'Routing messages' CONFIG_RTNETLINK
  tristate 'Netlink device emulation' CONFIG_NETLINK_DEV
fi
bool 'Network firewalls' CONFIG_FIREWALL
bool 'Network aliasing'  CONFIG_NET_ALIAS
bool 'Socket Filtering'  CONFIG_FILTER
tristate 'Unix domain sockets' CONFIG_UNIX
bool 'TCP/IP networking' CONFIG_INET
if [ "$CONFIG_INET" = "y" ]; then
  source net/ipv4/Config.in
  if [ "$CONFIG_EXPERIMENTAL" = "y" ]; then
#   Sorry, but IPv6 as module is still invalid.
    tristate 'The IPv6 protocol (EXPERIMENTAL)' CONFIG_IPV6
#   bool 'The IPv6 protocol (EXPERIMENTAL)' CONFIG_IPV6
    if [ "$CONFIG_IPV6" != "n" ]; then
	    source net/ipv6/Config.in
    fi
  fi
fi

comment ' '
tristate 'The IPX protocol' CONFIG_IPX
if [ "$CONFIG_IPX" != "n" ]; then
  source net/ipx/Config.in
fi
tristate 'Appletalk DDP' CONFIG_ATALK
if [ "$CONFIG_EXPERIMENTAL" = "y" ]; then
#  tristate 'DECnet Support (NOT YET FUNCTIONAL)' CONFIG_DECNET
#  if [ "$CONFIG_DECNET" != "n" ]; then
#    source net/decnet/Config.in
#  fi
  tristate 'CCITT X.25 Packet Layer (EXPERIMENTAL)' CONFIG_X25
  tristate 'LAPB Data Link Driver (EXPERIMENTAL)' CONFIG_LAPB
  bool 'Bridging (EXPERIMENTAL)' CONFIG_BRIDGE
  bool '802.2 LLC (EXPERIMENTAL)' CONFIG_LLC
#  if [ "$CONFIG_LLC" = "y" ]; then
#   bool 'Netbeui (EXPERIMENTAL)' CONFIG_NETBEUI
#  fi
  tristate 'Acorn Econet/AUN protocols (EXPERIMENTAL)' CONFIG_ECONET
  if [ "$CONFIG_ECONET" != "n" ]; then
    bool '  AUN over UDP' CONFIG_ECONET_AUNUDP
    bool '  Native Econet' CONFIG_ECONET_NATIVE
  fi
  tristate 'WAN router' CONFIG_WAN_ROUTER
  bool 'Fast switching (read help!)' CONFIG_NET_FASTROUTE
  bool 'Forwarding between high speed interfaces' CONFIG_NET_HW_FLOWCONTROL
  bool 'CPU is too slow to handle full bandwidth' CONFIG_CPU_IS_SLOW
  if [ "$CONFIG_EXPERIMENTAL" = "y" ]; then
  mainmenu_option next_comment
  comment 'QoS and/or fair queueing'
  bool 'QoS and/or fair queueing' CONFIG_NET_SCHED
  if [ "$CONFIG_NET_SCHED" = "y" ]; then
    source net/sched/Config.in
  fi
#  bool 'Network code profiler' CONFIG_NET_PROFILE
  endmenu
  fi
fi
endmenu
```

## net/irda/Config.in
```kconfig
#
# IrDA protocol configuration
#

if [ "$CONFIG_EXPERIMENTAL" = "y" ]; then
  if [ "$CONFIG_NET" != "n" ] ; then

    mainmenu_option next_comment
    comment 'IrDA subsystem support'
    dep_tristate 'IrDA subsystem support' CONFIG_IRDA $CONFIG_EXPERIMENTAL $CONFIG_NET

    if [ "$CONFIG_IRDA" != "n" ] ; then
      comment 'IrDA protocols'
      source net/irda/irlan/Config.in
      source net/irda/irobex/Config.in
      source net/irda/ircomm/Config.in
      source net/irda/irlpt/Config.in

      bool 'IrDA protocol options' CONFIG_IRDA_OPTIONS
      if [ "$CONFIG_IRDA_OPTIONS" != "n" ] ; then
        comment '   IrDA options'
        bool '   Cache last LSAP' CONFIG_IRDA_CACHE_LAST_LSAP
	bool '   Fast RRs' CONFIG_IRDA_FAST_RR
        bool '   Recycle RRs' CONFIG_IRDA_RECYCLE_RR
	bool '   Debug information' CONFIG_IRDA_DEBUG
      fi
    fi

    if [ "$CONFIG_IRDA" != "n" ] ; then
      source net/irda/compressors/Config.in
      source drivers/net/irda/Config.in
    fi
  endmenu

  fi
fi
```
