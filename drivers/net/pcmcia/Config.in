## drivers/sound/Config.in
```kconfig
# drivers/sound/Config.in
#
# 18 Apr 1998, Michael Elizabeth Chastain, <mailto:mec@shout.net>
# More hacking for modularisation.
#
# See drivers/sound/README.CONFIG for more information.



# Prompt user for primary drivers.

dep_tristate 'Ensoniq AudioPCI (ES1370)' CONFIG_SOUND_ES1370 $CONFIG_SOUND
if [ "$CONFIG_SOUND_ES1370" = "y" ]; then
   bool 'Joystick support at boot time' CONFIG_SOUND_ES1370_JOYPORT_BOOT
fi  
dep_tristate 'Creative Ensoniq AudioPCI 97 (ES1371)' CONFIG_SOUND_ES1371 $CONFIG_SOUND
if [ "$CONFIG_SOUND_ES1371" = "y" ]; then
   bool 'Joystick support at boot time' CONFIG_SOUND_ES1371_JOYPORT_BOOT
   if [ "$CONFIG_SOUND_ES1371_JOYPORT_BOOT" = "y" ]; then
      hex 'Gameport I/O 200,208,210,218' CONFIG_SOUND_ES1371_GAMEPORT 200
   fi
fi
dep_tristate 'S3 SonicVibes' CONFIG_SOUND_SONICVIBES $CONFIG_SOUND

dep_tristate 'Support for Turtle Beach MultiSound Classic, Tahiti, Monterey' CONFIG_SOUND_MSNDCLAS $CONFIG_SOUND
if [ "$CONFIG_SOUND_MSNDCLAS" = "y" -o "$CONFIG_SOUND_MSNDCLAS" = "m" ]; then
   if [ "$CONFIG_SOUND_MSNDCLAS" = "y" ]; then
     comment 'Compiled-in MSND Classic support requires firmware during compilation.'
     define_bool CONFIG_MSNDCLAS_HAVE_BOOT y
   else
     define_bool CONFIG_MSNDCLAS_HAVE_BOOT n
   fi
   string '  Full pathname of MSNDINIT.BIN firmware file' CONFIG_MSNDCLAS_INIT_FILE "/etc/sound/msndinit.bin"
   string '  Full pathname of MSNDPERM.BIN firmware file' CONFIG_MSNDCLAS_PERM_FILE "/etc/sound/msndperm.bin"
fi
if [ "$CONFIG_SOUND_MSNDCLAS" = "y" ]; then
   int 'MSND Classic IRQ 5,7,9,10,11,12' CONFIG_MSNDCLAS_IRQ 5
   hex 'MSND Classic memory B0000,C8000,D0000,D8000,E0000,E8000' CONFIG_MSNDCLAS_MEM D0000
   hex 'MSND Classic I/O 210,220,230,240,250,260,290,3E0' CONFIG_MSNDCLAS_IO 290
fi

dep_tristate 'Support for Turtle Beach MultiSound Pinnacle, Fiji' CONFIG_SOUND_MSNDPIN $CONFIG_SOUND
if [ "$CONFIG_SOUND_MSNDPIN" = "y" -o "$CONFIG_SOUND_MSNDPIN" = "m" ]; then
   if [ "$CONFIG_SOUND_MSNDPIN" = "y" ]; then
     comment 'Compiled-in MSND Pinnacle support requires firmware during compilation.'
     define_bool CONFIG_MSNDPIN_HAVE_BOOT y
   else
     define_bool CONFIG_MSNDPIN_HAVE_BOOT n
   fi
   string '  Full pathname of PNDSPINI.BIN firmware file' CONFIG_MSNDPIN_INIT_FILE "/etc/sound/pndspini.bin"
   string '  Full pathname of PNDSPERM.BIN firmware file' CONFIG_MSNDPIN_PERM_FILE "/etc/sound/pndsperm.bin"
fi
if [ "$CONFIG_SOUND_MSNDPIN" = "y" ]; then
   int 'MSND Pinnacle IRQ 5,7,9,10,11,12' CONFIG_MSNDPIN_IRQ 5
   hex 'MSND Pinnacle memory B0000,C8000,D0000,D8000,E0000,E8000' CONFIG_MSNDPIN_MEM D0000
   hex 'MSND Pinnacle I/O 210,220,230,240,250,260,290,3E0' CONFIG_MSNDPIN_IO 290
   bool 'MSND Pinnacle has S/PDIF I/O' CONFIG_MSNDPIN_DIGITAL
   bool 'MSND Pinnacle non-PnP Mode' CONFIG_MSNDPIN_NONPNP
   if [ "$CONFIG_MSNDPIN_NONPNP" = "y" ]; then
     comment 'MSND Pinnacle DSP section will be configured to above parameters.'
     hex 'MSND Pinnacle config port 250,260,270' CONFIG_MSNDPIN_CFG 250
     comment 'Pinnacle-specific Device Configuration (0 disables)'
     hex 'MSND Pinnacle MPU I/O (e.g. 330)' CONFIG_MSNDPIN_MPU_IO 0
     int 'MSND Pinnacle MPU IRQ (e.g. 9)' CONFIG_MSNDPIN_MPU_IRQ 0
     hex 'MSND Pinnacle IDE I/O 0 (e.g. 170)' CONFIG_MSNDPIN_IDE_IO0 0
     hex 'MSND Pinnacle IDE I/O 1 (e.g. 376)' CONFIG_MSNDPIN_IDE_IO1 0
     int 'MSND Pinnacle IDE IRQ (e.g. 15)' CONFIG_MSNDPIN_IDE_IRQ 0
     hex 'MSND Pinnacle joystick I/O (e.g. 200)' CONFIG_MSNDPIN_JOYSTICK_IO 0
   fi
fi
if [ "$CONFIG_SOUND_MSNDPIN" = "y" -o "$CONFIG_SOUND_MSNDCLAS" = "y" ]; then
   int 'MSND buffer size (kB)' CONFIG_MSND_FIFOSIZE 128
fi

dep_tristate 'OSS sound modules' CONFIG_SOUND_OSS $CONFIG_SOUND

if [ "$CONFIG_SOUND_OSS" = "y" -o "$CONFIG_SOUND_OSS" = "m" ]; then
  dep_tristate 'ProAudioSpectrum 16 support' CONFIG_SOUND_PAS $CONFIG_SOUND_OSS
  if [ "$CONFIG_SOUND_PAS" = "y" ]; then
      int 'PAS16 IRQ 3, 4, 5, 7, 9, 10, 11, 12, 14 or 15' CONFIG_PAS_IRQ 10
      int 'PAS16 DMA 0, 1, 3, 5, 6 or 7' CONFIG_PAS_DMA 3
      bool 'Enable PAS16 joystick port' CONFIG_PAS_JOYSTICK
  fi
  
  dep_tristate '100% Sound Blaster compatibles (SB16/32/64, ESS, Jazz16) support' CONFIG_SOUND_SB $CONFIG_SOUND_OSS
  if [ "$CONFIG_SOUND_SB" = "y" ]; then
      hex 'I/O base for SB Check from manual of the card' CONFIG_SB_BASE 220
      int 'Sound Blaster IRQ Check from manual of the card' CONFIG_SB_IRQ 7
      int 'Sound Blaster DMA 0, 1 or 3' CONFIG_SB_DMA 1
      int 'Sound Blaster 16 bit DMA (SB16, Jazz16, SMW) 5, 6 or 7 (use 1 for 8 bit cards)' CONFIG_SB_DMA2 5
      hex 'MPU401 I/O base of SB16, Jazz16 and ES1688 Check from manual of the card' CONFIG_SB_MPU_BASE 330
      comment 'MPU401 IRQ is only required with Jazz16, SM Wave and ESS1688.'
      comment 'Enter -1 to the following question if you have something else such as SB16/32.'
      int 'SB MPU401 IRQ (Jazz16, SM Wave and ES1688) Check from manual of the card' CONFIG_SB_MPU_IRQ -1
  fi
  
  dep_tristate 'Generic OPL2/OPL3 FM synthesizer support' CONFIG_SOUND_ADLIB $CONFIG_SOUND_OSS
  
  dep_tristate 'Gravis Ultrasound support' CONFIG_SOUND_GUS $CONFIG_SOUND_OSS
  if [ "$CONFIG_SOUND_GUS" = "y" -o "$CONFIG_SOUND_GUS" = "m" ]; then
      bool '16 bit sampling option of GUS (_NOT_ GUS MAX)' CONFIG_GUS16 
      bool 'GUS MAX support' CONFIG_GUSMAX
  fi
  if [ "$CONFIG_SOUND_GUS" = "y" ]; then
      hex 'I/O base for GUS 210, 220, 230, 240, 250 or 260' CONFIG_GUS_BASE 220
      int 'GUS IRQ 3, 5, 7, 9, 11, 12 or 15' CONFIG_GUS_IRQ 15
      int 'GUS DMA 1, 3, 5, 6 or 7' CONFIG_GUS_DMA 6
      int 'Second DMA channel for GUS 1, 3, 5, 6 or 7' CONFIG_GUS_DMA2 -1
      if [ "$CONFIG_GUS16" = "y" ]; then
  	hex 'I/O base for the 16 bit daughtercard of GUS 530, 604, E80 or F40' CONFIG_GUS16_BASE 530
  	int 'GUS 16 bit daughtercard IRQ 3, 4, 5, 7, or 9' CONFIG_GUS16_IRQ 7
  	int 'GUS DMA 0, 1 or 3' CONFIG_GUS16_DMA 3
      fi
  fi
  
  dep_tristate 'MPU-401 support (NOT for SB16)' CONFIG_SOUND_MPU401 $CONFIG_SOUND_OSS
  if [ "$CONFIG_SOUND_MPU401" = "y" ]; then
      hex 'I/O base for MPU401 Check from manual of the card' CONFIG_MPU_BASE 330
      int 'MPU401 IRQ Check from manual of the card' CONFIG_MPU_IRQ 9
  fi
  
  dep_tristate 'PSS (AD1848, ADSP-2115, ESC614) support' CONFIG_SOUND_PSS $CONFIG_SOUND_OSS
  if [ "$CONFIG_SOUND_PSS" = "y" ]; then
      hex 'PSS I/O base 220 or 240' CONFIG_PSS_BASE 220
      hex 'PSS audio I/O base 530, 604, E80 or F40' CONFIG_PSS_MSS_BASE 530
      int 'PSS audio IRQ 7, 9, 10 or 11' CONFIG_PSS_MSS_IRQ 11
      int 'PSS audio DMA 0, 1 or 3' CONFIG_PSS_MSS_DMA 3
      hex 'PSS MIDI I/O base ' CONFIG_PSS_MPU_BASE 330
      int 'PSS MIDI IRQ 3, 4, 5, 7, 9, 10, 11, 12' CONFIG_PSS_MPU_IRQ 9
      bool '  Have DSPxxx.LD firmware file' CONFIG_PSS_HAVE_BOOT
      if [ "$CONFIG_PSS_HAVE_BOOT" = "y" ]; then
         string '  Full pathname of DSPxxx.LD firmware file' CONFIG_PSS_BOOT_FILE /etc/sound/dsp001.ld
      fi
  fi
  if [ "$CONFIG_SOUND_PSS" = "y" -o "$CONFIG_SOUND_PSS" = "m" ]; then
      bool '  Enable PSS mixer (Beethoven ADSP-16 and other compatibile)' CONFIG_PSS_MIXER
  fi
  
  dep_tristate 'Microsoft Sound System support' CONFIG_SOUND_MSS $CONFIG_SOUND_OSS
  if [ "$CONFIG_SOUND_MSS" = "y" ]; then
      hex 'MSS/WSS I/O base 530, 604, E80 or F40' CONFIG_MSS_BASE 530
      int 'MSS/WSS IRQ 7, 9, 10 or 11' CONFIG_MSS_IRQ 11
      int 'MSS/WSS DMA 0, 1 or 3' CONFIG_MSS_DMA 3
      int 'MSS/WSS second DMA (if possible) 0, 1 or 3' CONFIG_MSS_DMA2 -1
  fi
  
  dep_tristate 'Ensoniq SoundScape support' CONFIG_SOUND_SSCAPE $CONFIG_SOUND_OSS
  if [ "$CONFIG_SOUND_SSCAPE" = "y" ]; then
      hex 'SoundScape MIDI I/O base 320, 330, 340 or 350' CONFIG_SSCAPE_BASE 330
      int 'SoundScape MIDI IRQ ' CONFIG_SSCAPE_IRQ 9
      int 'SoundScape initialization DMA 0, 1 or 3' CONFIG_SSCAPE_DMA 3
      hex 'SoundScape audio I/O base 534, 608, E84 or F44' CONFIG_SSCAPE_MSS_BASE 534
      int 'SoundScape audio IRQ 7, 9, 10 or 11' CONFIG_SSCAPE_MSS_IRQ 11
  fi
  
  dep_tristate 'MediaTrix AudioTrix Pro support' CONFIG_SOUND_TRIX $CONFIG_SOUND_OSS
  if [ "$CONFIG_SOUND_TRIX" = "y" ]; then
      hex 'TRIX audio I/O base 530, 604, E80 or F40' CONFIG_TRIX_BASE 530
      int 'TRIX audio IRQ 7, 9, 10 or 11' CONFIG_TRIX_IRQ 11
      int 'TRIX audio DMA 0, 1 or 3' CONFIG_TRIX_DMA 0
      int 'TRIX second (duplex) DMA 0, 1 or 3' CONFIG_TRIX_DMA2 3
      hex 'TRIX MIDI I/O base 330, 370, 3B0 or 3F0' CONFIG_TRIX_MPU_BASE 330
      int 'TRIX MIDI IRQ 3, 4, 5, 7 or 9' CONFIG_TRIX_MPU_IRQ 9
      hex 'TRIX SB I/O base 220, 210, 230, 240, 250, 260 or 270' CONFIG_TRIX_SB_BASE 220
      int 'TRIX SB IRQ 3, 4, 5 or 7' CONFIG_TRIX_SB_IRQ 7
      int 'TRIX SB DMA 1 or 3' CONFIG_TRIX_SB_DMA 1
      bool '  Have TRXPRO.HEX firmware file' CONFIG_TRIX_HAVE_BOOT
      if [ "$CONFIG_TRIX_HAVE_BOOT" = "y" ]; then
  	string '  Full pathname of TRXPRO.HEX firmware file' CONFIG_TRIX_BOOT_FILE /etc/sound/trxpro.hex
      fi
  fi
  
  dep_tristate 'Support for OPTi MAD16 and/or Mozart based cards' CONFIG_SOUND_MAD16 $CONFIG_SOUND_OSS
  if [ "$CONFIG_SOUND_MAD16" = "y" -o "$CONFIG_SOUND_MAD16" = "m" ]; then
    bool 'Support MIDI in older MAD16 based cards (requires SB)' CONFIG_MAD16_OLDCARD
  fi
  if [ "$CONFIG_SOUND_MAD16" = "y" ]; then
      hex 'MAD16 audio I/O base 530, 604, E80 or F40' CONFIG_MAD16_BASE 530
      int 'MAD16 audio IRQ 7, 9, 10 or 11' CONFIG_MAD16_IRQ 11
      int 'MAD16 audio DMA 0, 1 or 3' CONFIG_MAD16_DMA 3
      int 'MAD16 second (duplex) DMA 0, 1 or 3' CONFIG_MAD16_DMA2 0
      hex 'MAD16 MIDI I/O base 300, 310, 320 or 330 (0 disables)' CONFIG_MAD16_MPU_BASE 330
      int 'MAD16 MIDI IRQ 5, 7, 9 or 10' CONFIG_MAD16_MPU_IRQ 9
  fi
  
  dep_tristate 'Full support for Turtle Beach WaveFront (Tropez Plus, Tropez, Maui) synth/soundcards' CONFIG_SOUND_WAVEFRONT $CONFIG_SOUND_OSS m
  if [ "$CONFIG_SOUND_WAVEFRONT" = "y" ]; then
      hex 'I/O base for WaveFront 210, 230, 260, 290, 300, 320, 338 or 330' CONFIG_WAVEFRONT_BASE 330
      int 'WaveFront IRQ 5, 9, 12 or 15' CONFIG_WAVEFRONT_IRQ 9
  fi

  dep_tristate 'Support for Crystal CS4232 based (PnP) cards' CONFIG_SOUND_CS4232 $CONFIG_SOUND_OSS
  if [ "$CONFIG_SOUND_CS4232" = "y" ]; then
      hex 'CS4232 audio I/O base (normally 530, 604, E80 or F40)' CONFIG_CS4232_BASE 530
      int 'CS4232 audio IRQ 5, 7, 9, 11, 12 or 15' CONFIG_CS4232_IRQ 11
      int 'CS4232 audio DMA 0, 1 or 3' CONFIG_CS4232_DMA 0
      int 'CS4232 second (duplex) DMA 0, 1 or 3' CONFIG_CS4232_DMA2 3
      hex 'CS4232 MIDI I/O base 330, 370, 3B0 or 3F0' CONFIG_CS4232_MPU_BASE 330
      int 'CS4232 MIDI IRQ 5, 7, 9, 11, 12 or 15' CONFIG_CS4232_MPU_IRQ 9
  fi

  dep_tristate 'Support for Yamaha OPL3-SA2, SA3, and SAx based PnP cards' CONFIG_SOUND_OPL3SA2 $CONFIG_SOUND_OSS
  if [ "$CONFIG_SOUND_OPL3SA2" = "y" ]; then
      int 'Chipset (-1 for autoprobe, 2, or 3)' CONFIG_OPL3SA2_CHIPSET -1
      hex 'OPL3SA2 audio I/O base (530 - F48 valid)' CONFIG_OPL3SA2_BASE 530
      int 'OPL3SA2 audio IRQ 5, 7, 9, 11, 12 or 15' CONFIG_OPL3SA2_IRQ 9
      int 'OPL3SA2 audio DMA 0, 1 or 3' CONFIG_OPL3SA2_DMA 0
      int 'OPL3SA2 second (duplex) DMA 0, 1 or 3' CONFIG_OPL3SA2_DMA2 1
      hex 'OPL3SA2 control I/O base (100 - FFE valid)' CONFIG_OPL3SA2_CTRL_BASE 370
      hex 'OPL3SA2 MIDI I/O base (300 - 334 valid)' CONFIG_OPL3SA2_MPU_BASE 330
      int 'OPL3SA2 MIDI IRQ 5, 7, 9, 11, 12 or 15' CONFIG_OPL3SA2_MPU_IRQ 9
  fi

  dep_tristate 'Limited support for Turtle Beach Wave Front (Maui, Tropez) synthesizers' CONFIG_SOUND_MAUI $CONFIG_SOUND_OSS
  if [ "$CONFIG_SOUND_MAUI" = "y" ]; then
      hex 'I/O base for Maui 210, 230, 260, 290, 300, 320, 338 or 330' CONFIG_MAUI_BASE 330
      int 'Maui IRQ 5, 9, 12 or 15' CONFIG_MAUI_IRQ 9
      bool '  Have OSWF.MOT firmware file' CONFIG_MAUI_HAVE_BOOT
      if [ "$CONFIG_MAUI_HAVE_BOOT" = "y" ]; then
  	string '  Full pathname of OSWF.MOT firmware file' CONFIG_MAUI_BOOT_FILE /etc/sound/oswf.mot
      fi
  fi

  
  dep_tristate 'Support for Aztech Sound Galaxy (non-PnP) cards' CONFIG_SOUND_SGALAXY $CONFIG_SOUND_OSS
  if [ "$CONFIG_SOUND_SGALAXY" = "y" ]; then
      hex 'SGALAXY audio I/O base 530, 604, E80 or F40' CONFIG_SGALAXY_BASE 530
      int 'SGALAXY audio IRQ 5, 7, 9, 11, 12 or 15' CONFIG_SGALAXY_IRQ 11
      int 'SGALAXY audio DMA 0, 1 or 3' CONFIG_SGALAXY_DMA 0
      int 'SGALAXY second (duplex) DMA 0, 1 or 3' CONFIG_SGALAXY_DMA2 3
      hex 'SGALAXY SB I/O base 220 or 240' CONFIG_SGALAXY_SGBASE 220
  fi

  if [ "$CONFIG_EXPERIMENTAL" = "y" ]; then
    dep_tristate 'Support for AD1816(A) based cards (EXPERIMENTAL)' CONFIG_SOUND_AD1816 $CONFIG_SOUND
    if [ "$CONFIG_SOUND_AD1816" = "y" ]; then
      hex 'AD1816 audio I/O base 530, 604, E80 or F40' CONFIG_AD1816_BASE 530
      int 'AD1816 audio IRQ 5, 7, 9, 11, 12 or 15' CONFIG_AD1816_IRQ 7
      int 'AD1816 audio DMA 0, 1 or 3' CONFIG_AD1816_DMA 0
      int 'AD1816 second (duplex) DMA 0, 1 or 3' CONFIG_AD1816_DMA2 3
      int 'AD1816 clock chip frequency' CONFIG_AD1816_CLOCK 33000
    fi
  fi
  
  dep_tristate 'Yamaha OPL3-SA1 audio controller' CONFIG_SOUND_OPL3SA1 $CONFIG_SOUND_OSS
  if [ "$CONFIG_SOUND_OPL3SA1" = "y" ]; then
      hex 'OPL3-SA1 audio I/O base 530, 604, E80 or F40' CONFIG_OPL3SA1_BASE 530
      int 'OPL3-SA1 audio IRQ 7, 9, 10 or 11' CONFIG_OPL3SA1_IRQ 11
      int 'OPL3-SA1 audio DMA 0, 1 or 3' CONFIG_OPL3SA1_DMA 0
      int 'OPL3-SA1 second (duplex) DMA 0, 1 or 3' CONFIG_OPL3SA1_DMA2 3
      hex 'OPL3-SA1 MIDI I/O base 330, 370, 3B0 or 3F0' CONFIG_OPL3SA1_MPU_BASE 330
      int 'OPL3-SA1 MIDI IRQ 3, 4, 5, 7 or 9' CONFIG_OPL3SA1_MPU_IRQ 9
  fi
  
  dep_tristate 'SoftOSS software wave table engine' CONFIG_SOUND_SOFTOSS $CONFIG_SOUND_OSS
  if [ "$CONFIG_SOUND_SOFTOSS" = "y" ]; then
      int 'Sampling rate for SoftOSS 8000 to 48000' CONFIG_SOFTOSS_RATE 22050
      int 'Max # of concurrent voices for SoftOSS 4 to 32' CONFIG_SOFTOSS_VOICES 32
  fi
  
  dep_tristate 'FM synthesizer (YM3812/OPL-3) support' CONFIG_SOUND_YM3812 $CONFIG_SOUND_OSS
  
  dep_tristate 'Loopback MIDI device support' CONFIG_SOUND_VMIDI $CONFIG_SOUND_OSS
  
  dep_tristate '6850 UART support' CONFIG_SOUND_UART6850 $CONFIG_SOUND_OSS
  if [ "$CONFIG_SOUND_UART6850" = "y" ]; then
      hex 'I/O base for UART 6850 MIDI port (Unknown)' CONFIG_U6850_BASE 0
      int 'UART6850 IRQ (Unknown)' CONFIG_U6850_IRQ -1
  fi
  
  if [ "$CONFIG_ARM" = "y" ]; then
    dep_tristate 'VIDC 16-bit sound' CONFIG_SOUND_VIDC $CONFIG_SOUND_OSS
    dep_tristate 'Netwinder WaveArtist' CONFIG_SOUND_WAVEARTIST $CONFIG_SOUND_OSS
    if [ "$CONFIG_SOUND_WAVEARTIST" != "n" ]; then
      hex '  WaveArtist I/O base' CONFIG_WAVEARTIST_BASE 250
      int '  WaveArtist IRQ' CONFIG_WAVEARTIST_IRQ 28
      int '  WaveArtist DMA' CONFIG_WAVEARTIST_DMA 3
      int '  WaveArtist second DMA' CONFIG_WAVEARTIST_DMA2 7
    fi
  fi
  
  
  
  # Additional low level drivers.
  
  mainmenu_option next_comment
  comment 'Additional low level sound drivers'
  bool 'Additional low level sound drivers' CONFIG_LOWLEVEL_SOUND $CONFIG_SOUND_OSS
  if [ "$CONFIG_LOWLEVEL_SOUND" = "y" ]; then
      source drivers/sound/lowlevel/Config.in
  fi
  endmenu
fi
```
